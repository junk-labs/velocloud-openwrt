## edge5x0_firmware/ADI_coreboot/coreboot/src/cpu/intel/fsp_model_206ax/Kconfig
```kconfig
##
## This file is part of the coreboot project.
##
## Copyright (C) 2013-2014 Sage Electronic Engineering, LLC.
##
## This program is free software; you can redistribute it and/or modify
## it under the terms of the GNU General Public License as published by
## the Free Software Foundation; version 2 of the License.
##
## This program is distributed in the hope that it will be useful,
## but WITHOUT ANY WARRANTY; without even the implied warranty of
## MERCHANTABILITY or FITNESS FOR A PARTICULAR PURPOSE.  See the
## GNU General Public License for more details.
##
## You should have received a copy of the GNU General Public License
## along with this program; if not, write to the Free Software
## Foundation, Inc., 51 Franklin St, Fifth Floor, Boston, MA 02110-1301 USA
##


config CPU_INTEL_FSP_MODEL_206AX
	bool

config CPU_INTEL_FSP_MODEL_306AX
	bool

if CPU_INTEL_FSP_MODEL_206AX || CPU_INTEL_FSP_MODEL_306AX

config CPU_SPECIFIC_OPTIONS
	def_bool y
	select PLATFORM_USES_FSP
	select ARCH_BOOTBLOCK_X86_32
	select ARCH_ROMSTAGE_X86_32
	select ARCH_RAMSTAGE_X86_32
	select SMP
	select SSE2
	select UDELAY_LAPIC
	select SMM_TSEG
	select SUPPORT_CPU_UCODE_IN_CBFS if HAVE_FSP_BIN
	select PARALLEL_CPU_INIT
	select TSC_SYNC_MFENCE
	select SAVE_EARLY_TIMESTAMPS_TO_CMOS if COLLECT_TIMESTAMPS

config BOOTBLOCK_CPU_INIT
	string
	default "cpu/intel/fsp_model_206ax/bootblock.c"

config SMM_TSEG_SIZE
	hex
	default 0x800000

config ENABLE_VMX
	bool "Enable VMX for virtualization"
	default n

config CPU_MICROCODE_CBFS_LOC
	hex
	depends on SUPPORT_CPU_UCODE_IN_CBFS
	default 0xfff70040

config MICROCODE_INCLUDE_PATH
	string "Location of the intel microcode patches"
	default "../intel/cpu/ivybridge/microcode" if CPU_INTEL_FSP_MODEL_306AX
	default "../intel/cpu/sandybridge/microcode" if CPU_INTEL_FSP_MODEL_206AX

config USE_COREBOOT_MTRR_SETUP
	bool "Use coreboot MTRR setup instead of the FSP's"
	default y
	help
		The FSP MTRR setup for this platform has issues with
		memory above 4 GB. The coreboot MTRR setup does not
		exhibit the same problem and significantly increases
		the performance of the platform.

config EXCLUDE_306A2_MICROCODE
	bool
	depends on SUPPORT_CPU_UCODE_IN_CBFS
	default n

config EXCLUDE_306A4_MICROCODE
	bool
	depends on SUPPORT_CPU_UCODE_IN_CBFS
	default n

config EXCLUDE_306A5_MICROCODE
	bool
	depends on SUPPORT_CPU_UCODE_IN_CBFS
	default n

config EXCLUDE_306A8_MICROCODE
	bool
	depends on SUPPORT_CPU_UCODE_IN_CBFS
	default n

config EXCLUDE_306A9_MICROCODE
	bool
	depends on SUPPORT_CPU_UCODE_IN_CBFS
	default n

config DISABLE_TURBO
	bool
	default n

endif
```

## edge5x0_firmware/ADI_coreboot/coreboot/src/southbridge/intel/Kconfig
```kconfig
source src/southbridge/intel/common/Kconfig
source src/southbridge/intel/fsp_rangeley/Kconfig
```

## firmware/ADI_coreboot/coreboot/src/cpu/intel/socket_BGA1284/Kconfig
```kconfig
config CPU_INTEL_SOCKET_BGA1284
	bool

if CPU_INTEL_SOCKET_BGA1284

config SOCKET_SPECIFIC_OPTIONS # dummy
	def_bool y
	select MMX
	select SSE
	select CACHE_AS_RAM

config CACHE_MRC_BIN
	bool
	default n

endif
```

## firmware/ADI_coreboot/coreboot/src/mainboard/intel/Kconfig
```kconfig
if VENDOR_INTEL

choice
	prompt "Mainboard model"
	default BOARD_INTEL_MOHONPEAK

config BOARD_INTEL_MOHONPEAK
	bool "Mohon Peak FSP"
config BOARD_INTEL_PAINTED_GORGE
	bool "Painted Gorge FSP"
endchoice

source "src/mainboard/intel/mohonpeak/Kconfig"
source "src/mainboard/intel/painted_gorge/Kconfig"
config MAINBOARD_VENDOR
	string
	default "Intel"

endif # VENDOR_INTEL
```

## firmware/ADI_coreboot/coreboot/src/mainboard/intel/painted_gorge/Kconfig
```kconfig
##
## This file is part of the coreboot project.
##
## Copyright (C) 2013-2014 Sage Electronic Engineering, LLC.
##
## This program is free software; you can redistribute it and/or modify
## it under the terms of the GNU General Public License as published by
## the Free Software Foundation; version 2 of the License.
##
## This program is distributed in the hope that it will be useful,
## but WITHOUT ANY WARRANTY; without even the implied warranty of
## MERCHANTABILITY or FITNESS FOR A PARTICULAR PURPOSE.  See the
## GNU General Public License for more details.
##
## You should have received a copy of the GNU General Public License
## along with this program; if not, write to the Free Software
## Foundation, Inc., 51 Franklin St, Fifth Floor, Boston, MA 02110-1301 USA
##

if BOARD_INTEL_PAINTED_GORGE

config BOARD_SPECIFIC_OPTIONS # dummy
	def_bool y
	select ARCH_X86
	select CPU_INTEL_SOCKET_RPGA989
	select NORTHBRIDGE_INTEL_FSP_RANGELEY
	select SOUTHBRIDGE_INTEL_FSP_RANGELEY
	select BOARD_ROMSIZE_KB_8192
	select HAVE_ACPI_TABLES
	select HAVE_OPTION_TABLE
	select MMCONF_SUPPORT
	select HAVE_FSP_BIN
	select HAVE_MP_TABLE
	select HAVE_PIRQ_TABLE
	select EARLY_CBMEM_INIT
	select DEFAULT_PAYLOAD_ELF

config MAINBOARD_DIR
	string
	default "intel/painted_gorge"

config MAINBOARD_PART_NUMBER
	string
	default "Painted Gorge"

config MMCONF_BASE_ADDRESS
	hex
	default 0xe0000000

config IRQ_SLOT_COUNT
	int
	default 18

config MAX_CPUS
	int
	default 16

config ME_PATH
	string
	default "../intel/mainboard/intel/painted_gorge/unlocked_descriptor"

config DRIVERS_PS2_KEYBOARD
	bool
	default n

config CONSOLE_POST
	bool
	default y

config DEFAULT_PAYLOAD_ELF
	bool
	default y

config PAYLOAD_USE_CONFIG_FILE
	string
	default "./payloads/seabios/configs/config.painted_gorge"

config SEABIOS_ENABLE_OPTIONS
	bool
	default y

config SEABIOS_ADD_BOOTORDER
	bool
	default y

config SEABIOS_BOOTORDER_FILE
	string
	default "./src/mainboard/intel/painted_gorge/bootorder"

config PAYLOAD_FILE
	string
	default "./payloads/seabios/out/bios.bin.elf"

config ENABLE_VMX
	bool
	default y

config CBFS_SIZE
	hex
	default 0x7f0000

config CACHE_ROM_SIZE_OVERRIDE
	hex
	default 0x800000

config ACPI_INCLUDE_GPIO
	bool
	default n

config ACPI_INCLUDE_PMIO
	bool
	default n

config UART_FOR_CONSOLE
        int
        default 1 # 1 = COM2

choice
	prompt "AHCI maximum Speed"
	default AHCI_MAX_GEN2

config AHCI_MAX_GEN3
	bool "6 GB/S - Gen 3"

config AHCI_MAX_GEN2
	bool "3 GB/S - Gen 2"

config AHCI_MAX_GEN1
	bool "1.5 GB/S - Gen 1"

endchoice

config AHCI_MAX_SPEED
	int
	default 1 if AHCI_MAX_GEN1
	default 3 if AHCI_MAX_GEN3
	default 2

endif # BOARD_INTEL_PAINTED_GORGE
```
