
/* DO NOT EDIT!  This is an autogenerated file.  See scripts/layoutrom.py. */
OUTPUT_FORMAT("elf32-i386")
OUTPUT_ARCH("i386")
SECTIONS
{
e820_list = 0x8928 ;
_cfunc32flat_call32_params_helper = 0xf6c40 ;
MaxPCIBus = 0x8bc8 ;
_cfunc32flat_handle_pmm = 0xf3d8a ;
pmode_IDT_info = 0x8d60 ;
e820_count = 0x8924 ;
TimerKHz = 0x8bc4 ;
LegacyRamSize = 0x8920 ;
StackSeg = 0xf7f0 ;
_cfunc32flat_process_sd_op = 0xf6e2a ;
CDRom_locks = 0xf7e0 ;
acpi_pm1a_cnt = 0x8900 ;
rmode_IDT_info = 0x8d68 ;
_cfunc32flat_handle_resume32 = 0xf6cda ;
emulated_drive_gf = 0xf7c8 ;
_cfunc32flat_xhci_poll_intr = 0xf6fb8 ;
_cfunc32flat_process_atapi_op = 0xf6cc2 ;
_cfunc32seg_handle_apm = 0x95bc ;
mouse_pipe = 0x8bb8 ;
StackPos = 0xf7f4 ;
_cfunc32flat_process_ahci_op = 0xf6f65 ;
CanPreempt = 0x8d10 ;
_cfunc32seg_handle_pcibios = 0x9219 ;
FloppyCount = 0x8d0c ;
ShiftTSC = 0x8bc0 ;
_cfunc32flat_handle_19 = 0xf6f2e ;
IDMap = 0x8c0c ;
MainThread = 0x8d14 ;
PirAddr = 0x8904 ;
CDEmu = 0xf7cc ;
cdemu_drive_gf = 0x8c04 ;
LastUSBkey = 0xf7b4 ;
keyboard_pipe = 0x8bbc ;
HaveRunPost = 0x8d70 ;
rombios32_gdt_48 = 0x8d20 ;
_cfunc32flat_yield_preempt = 0xf1ffe ;
Century = 0xf7c5 ;
ExtraStack = 0xf7f8 ;
diskette_param_table2 = 0x8ba8 ;
_cfunc32flat_handle_18 = 0xf6edd ;
TimerPort = 0x8bc2 ;
bounce_buf_fl = 0x8c08 ;
BIOS_CONFIG_TABLE = 0xe6f5 ;
RTCusers = 0xf7bc ;
_cfunc32flat_process_scsi_op = 0xf6c50 ;
TimerLast = 0xf7c0 ;
_cfunc32flat_handle_post = 0xf6e7e ;

    zonelow_base = 0x90000 ;
    _zonelow_seg = 0x9000 ;

.text.on_extra_stack 0xec35 : { *(.text.on_extra_stack) }
.text.invoke_mouse_handler 0x9890 : { *(.text.invoke_mouse_handler) }
.text.enqueue_key 0x98d7 : { *(.text.enqueue_key) }
.text.set_a20 0x993b : { *(.text.set_a20) }
.text.ps2_kbd_command 0x995b : { *(.text.ps2_kbd_command) }
.text.ps2_mouse_command 0xffea : { *(.text.ps2_mouse_command) }
.text.serial_debug 0x9961 : { *(.text.serial_debug) }
.text.serial_debug_putc 0x9989 : { *(.text.serial_debug_putc) }
.text.serial_debug_flush 0x99a6 : { *(.text.serial_debug_flush) }
.text.ehci_reset_pipe 0x99c3 : { *(.text.ehci_reset_pipe) }
.text.usb_kbd_command 0x9a06 : { *(.text.usb_kbd_command) }
.text.usb_mouse_command 0x9a21 : { *(.text.usb_mouse_command) }
.text.stack_hop 0x9a93 : { *(.text.stack_hop) }
.text.send_disk_op 0x9af8 : { *(.text.send_disk_op) }
.text.stack_hop_back 0xefdb : { *(.text.stack_hop_back) }
.text._farcall16 0x9b07 : { *(.text._farcall16) }
.text.farcall16 0x9b48 : { *(.text.farcall16) }
.text.process_mouse 0xef60 : { *(.text.process_mouse) }
.text.check_irqs 0x9b51 : { *(.text.check_irqs) }
.text.wait_irq 0x9b73 : { *(.text.wait_irq) }
.text.dequeue_key 0x9b93 : { *(.text.dequeue_key) }
.text.getLCHS 0x9c61 : { *(.text.getLCHS) }
.text.puts_cs.isra.21 0xf046 : { *(.text.puts_cs.isra.21) }
.text.putsinglehex.isra.22 0xe2aa : { *(.text.putsinglehex.isra.22) }
.text.puthex.isra.23 0xeeae : { *(.text.puthex.isra.23) }
.text.putprettyhex.isra.24 0x9cdf : { *(.text.putprettyhex.isra.24) }
.text.kbd_command 0x9d2a : { *(.text.kbd_command) }
.text.set_leds 0x9d46 : { *(.text.set_leds) }
.text.handle_160a.isra.35 0xfeae : { *(.text.handle_160a.isra.35) }
.text.mouse_command 0x9da5 : { *(.text.mouse_command) }
.text.call32.part.73 0x9dc1 : { *(.text.call32.part.73) }
.text.clear_usertimer 0x9e7a : { *(.text.clear_usertimer) }
.text.memset.constprop.85 0x9ebd : { *(.text.memset.constprop.85) }
.text.set_success 0xe827 : { *(.text.set_success) }
.text.set_code_success 0x9ecd : { *(.text.set_code_success) }
.text.pci_next 0x9ed9 : { *(.text.pci_next) }
.text.rtc_setup 0xfe7e : { *(.text.rtc_setup) }
.text.set_usertimer 0xe671 : { *(.text.set_usertimer) }
.text.timer_read 0x9f64 : { *(.text.timer_read) }
.text.timer_sleep 0xe6ff : { *(.text.timer_sleep) }
.text.rtc_updating 0xa00e : { *(.text.rtc_updating) }
.text.putuint.isra.26 0xa065 : { *(.text.putuint.isra.26) }
.text.bvprintf.isra.27 0xe079 : { *(.text.bvprintf.isra.27) }
.text.__dprintf 0xa0ac : { *(.text.__dprintf) }
.text.dump_regs 0xe742 : { *(.text.dump_regs) }
.text.__warn_invalid 0xa0c6 : { *(.text.__warn_invalid) }
.text.__set_code_invalid 0xa0f8 : { *(.text.__set_code_invalid) }
.text.mouse_15c201 0xa11e : { *(.text.mouse_15c201) }
.text.__disk_ret 0xf06e : { *(.text.__disk_ret) }
.text.disk_1300 0xa174 : { *(.text.disk_1300) }
.text.disk_1308 0xa1af : { *(.text.disk_1308) }
.text.disk_1310 0xa2e3 : { *(.text.disk_1310) }
.text.disk_1315 0xa322 : { *(.text.disk_1315) }
.text.disk_1346.isra.61 0xa38a : { *(.text.disk_1346.isra.61) }
.text.basic_access 0xa440 : { *(.text.basic_access) }
.text.extended_access 0xa59b : { *(.text.extended_access) }
.text.__set_invalid 0xe973 : { *(.text.__set_invalid) }
.text.getComAddr 0xa689 : { *(.text.getComAddr) }
.text.__debug_enter 0xa6d9 : { *(.text.__debug_enter) }
.text.process_key 0xa705 : { *(.text.process_key) }
.text.prockeys 0xaa64 : { *(.text.prockeys) }
.text.procmodkey 0xff00 : { *(.text.procmodkey) }
.text.procscankey.part.72 0xaaae : { *(.text.procscankey.part.72) }
.text.ehci_wait_td 0xe837 : { *(.text.ehci_wait_td) }
.text.ehci_send_bulk 0xaacb : { *(.text.ehci_send_bulk) }
.text.usb_send_bulk 0xacfb : { *(.text.usb_send_bulk) }
.text.usb_cmd_data 0xad2b : { *(.text.usb_cmd_data) }
.text.disk_1305 0xaeff : { *(.text.disk_1305) }
.text.__set_code_unimplemented 0xb026 : { *(.text.__set_code_unimplemented) }
.text.__disk_ret_unimplemented 0xb077 : { *(.text.__disk_ret_unimplemented) }
.text.__disk_stub 0xb09f : { *(.text.__disk_stub) }
.text.__set_unimplemented 0xb0f2 : { *(.text.__set_unimplemented) }
.text.handle_1553 0xfcba : { *(.text.handle_1553) }
.text.panic 0xb12c : { *(.text.panic) }
.text.virtio_scsi_cmd 0xf869 : { *(.text.virtio_scsi_cmd) }
.text.cdb_cmd_data 0xb148 : { *(.text.cdb_cmd_data) }
.text.cdb_write 0xb229 : { *(.text.cdb_write) }
.text.cdb_read 0xb284 : { *(.text.cdb_read) }
.text.process_scsi_op 0xb2df : { *(.text.process_scsi_op) }
.text.fill_generic_edd.constprop.80 0xb31d : { *(.text.fill_generic_edd.constprop.80) }
.text.fill_edd 0xf7b8 : { *(.text.fill_edd) }
.text.disk_13 0xb633 : { *(.text.disk_13) }
.text.handle_legacy_disk 0xba1c : { *(.text.handle_legacy_disk) }
.text.handle_12 0xbaca : { *(.text.handle_12) }
.text.handle_11 0xbaef : { *(.text.handle_11) }
.text.handle_05 0xe3f5 : { *(.text.handle_05) }
.text.handle_10 0xe727 : { *(.text.handle_10) }
.text.handle_02 0xbb14 : { *(.text.handle_02) }
.text.handle_75 0xbb2f : { *(.text.handle_75) }
.text.call32 0xfe55 : { *(.text.call32) }
.text.process_op 0xbb97 : { *(.text.process_op) }
.text.cdemu_read 0xe411 : { *(.text.cdemu_read) }
.text.__send_disk_op 0xbd27 : { *(.text.__send_disk_op) }
.text.call32_params.constprop.84 0xbd77 : { *(.text.call32_params.constprop.84) }
.text.usb_poll_intr 0xe2cc : { *(.text.usb_poll_intr) }
.text.handle_40 0xbdbf : { *(.text.handle_40) }
.text.handle_13 0xbdde : { *(.text.handle_13) }
.text.handle_16 0xbe98 : { *(.text.handle_16) }
.text.handle_1589 0xbff2 : { *(.text.handle_1589) }
.text.handle_15 0xc093 : { *(.text.handle_15) }
.text.handle_14 0xec62 : { *(.text.handle_14) }
.text.handle_17 0xc7fd : { *(.text.handle_17) }
.text.handle_1a 0xe990 : { *(.text.handle_1a) }
.text.handle_08 0xf0fc : { *(.text.handle_08) }
.text.handle_70 0xc822 : { *(.text.handle_70) }
.text.handle_resume 0xc91f : { *(.text.handle_resume) }
.text.handle_pnp 0xc9f6 : { *(.text.handle_pnp) }
.text.handle_pcibios 0xca4b : { *(.text.handle_pcibios) }
.text.handle_apm 0xf84a : { *(.text.handle_apm) }
.text.handle_hwpic1 0xcdeb : { *(.text.handle_hwpic1) }
.text.handle_hwpic2 0xcdf1 : { *(.text.handle_hwpic2) }
.text.handle_09 0xe2c1 : { *(.text.handle_09) }
.text.handle_0e 0xfef1 : { *(.text.handle_0e) }
.text.asm.transition32 0xcdf9 : { *(.text.asm.transition32) }
.text.asm.transition16 0xce44 : { *(.text.asm.transition16) }
.text.asm.__call16 0xce9f : { *(.text.asm.__call16) }
.text.asm.__farcall16 0xff5d : { *(.text.asm.__farcall16) }
.text.asm.irq_trampoline_0x02 0xceee : { *(.text.asm.irq_trampoline_0x02) }
.text.asm.irq_trampoline_0x10 0xcef1 : { *(.text.asm.irq_trampoline_0x10) }
.text.asm.irq_trampoline_0x13 0xcef4 : { *(.text.asm.irq_trampoline_0x13) }
.text.asm.irq_trampoline_0x15 0xcef7 : { *(.text.asm.irq_trampoline_0x15) }
.text.asm.irq_trampoline_0x16 0xcefa : { *(.text.asm.irq_trampoline_0x16) }
.text.asm.irq_trampoline_0x18 0xcefd : { *(.text.asm.irq_trampoline_0x18) }
.text.asm.irq_trampoline_0x19 0xf83d : { *(.text.asm.irq_trampoline_0x19) }
.text.asm.irq_trampoline_0x1c 0xfe6b : { *(.text.asm.irq_trampoline_0x1c) }
.text.asm.irq_trampoline_0x4a 0xf856 : { *(.text.asm.irq_trampoline_0x4a) }
.text.asm.entry_resume 0xcf00 : { *(.text.asm.entry_resume) }
.text.asm.entry_pmm 0xcf15 : { *(.text.asm.entry_pmm) }
.text.asm.entry_pnp_real 0xcf5e : { *(.text.asm.entry_pnp_real) }
.text.asm.entry_apm16 0xcf96 : { *(.text.asm.entry_apm16) }
.text.asm.entry_apm32 0xcfd7 : { *(.text.asm.entry_apm32) }
.text.asm.entry_pcibios32 0xd009 : { *(.text.asm.entry_pcibios32) }
.text.asm.entry_pcibios16 0xd037 : { *(.text.asm.entry_pcibios16) }
.text.asm.entry_1589 0xd071 : { *(.text.asm.entry_1589) }
.text.asm.entry_bios32 0xd0ab : { *(.text.asm.entry_bios32) }
.text.asm.entry_elf 0xd0ca : { *(.text.asm.entry_elf) }
.text.asm.irqentry_extrastack 0xd0f5 : { *(.text.asm.irqentry_extrastack) }
.text.asm.irqentry_arg_extrastack 0xd15b : { *(.text.asm.irqentry_arg_extrastack) }
.text.asm.entry_13 0xd1fe : { *(.text.asm.entry_13) }
.text.asm.entry_70 0xd207 : { *(.text.asm.entry_70) }
.text.asm.entry_75 0xd210 : { *(.text.asm.entry_75) }
.text.asm.entry_hwpic1 0xd219 : { *(.text.asm.entry_hwpic1) }
.text.asm.entry_hwpic2 0xd222 : { *(.text.asm.entry_hwpic2) }
.text.asm.entry_19 0xd22b : { *(.text.asm.entry_19) }
.text.asm.entry_18 0xd23e : { *(.text.asm.entry_18) }
.rodata 0xd251 : { *(.rodata) }
.rodata.__func__.1756 0xd774 : { *(.rodata.__func__.1756) }
.rodata.__func__.1765 0xd780 : { *(.rodata.__func__.1765) }
.rodata.__func__.1774 0xd78c : { *(.rodata.__func__.1774) }
.rodata.__func__.1782 0xd798 : { *(.rodata.__func__.1782) }
.rodata.__func__.1795 0xd7a4 : { *(.rodata.__func__.1795) }
.rodata.__func__.4566 0xd7b0 : { *(.rodata.__func__.4566) }
.rodata.__func__.4496 0xd7bc : { *(.rodata.__func__.4496) }
.rodata.__func__.4219 0xd7c8 : { *(.rodata.__func__.4219) }
.rodata.__func__.8292 0xd7d4 : { *(.rodata.__func__.8292) }
.rodata.__func__.4175 0xd7e4 : { *(.rodata.__func__.4175) }
.rodata.__func__.4251 0xd7f4 : { *(.rodata.__func__.4251) }
.rodata.__func__.4292 0xd800 : { *(.rodata.__func__.4292) }
.rodata.__func__.4308 0xd80c : { *(.rodata.__func__.4308) }
.rodata.__func__.4313 0xd818 : { *(.rodata.__func__.4313) }
.rodata.__func__.4318 0xd824 : { *(.rodata.__func__.4318) }
.rodata.__func__.4325 0xd830 : { *(.rodata.__func__.4325) }
.rodata.__func__.4330 0xd83c : { *(.rodata.__func__.4330) }
.rodata.__func__.4335 0xd848 : { *(.rodata.__func__.4335) }
.rodata.__func__.4340 0xd854 : { *(.rodata.__func__.4340) }
.rodata.__func__.4350 0xd860 : { *(.rodata.__func__.4350) }
.rodata.__func__.4355 0xd86c : { *(.rodata.__func__.4355) }
.rodata.__func__.4197 0xd878 : { *(.rodata.__func__.4197) }
.rodata.__func__.4421 0xd888 : { *(.rodata.__func__.4421) }
.rodata.__func__.4379 0xd894 : { *(.rodata.__func__.4379) }
.rodata.__func__.4395 0xd8a0 : { *(.rodata.__func__.4395) }
.rodata.__func__.4411 0xd8ac : { *(.rodata.__func__.4411) }
.rodata.__func__.4416 0xd8b8 : { *(.rodata.__func__.4416) }
.rodata.__func__.4431 0xd8c4 : { *(.rodata.__func__.4431) }
.rodata.__func__.4451 0xd8d0 : { *(.rodata.__func__.4451) }
.rodata.__func__.4456 0xd8dc : { *(.rodata.__func__.4456) }
.rodata.__func__.4461 0xd8e8 : { *(.rodata.__func__.4461) }
.rodata.__func__.4466 0xd8f4 : { *(.rodata.__func__.4466) }
.rodata.__func__.4471 0xd900 : { *(.rodata.__func__.4471) }
.rodata.__func__.4476 0xd90c : { *(.rodata.__func__.4476) }
.rodata.__func__.4481 0xd918 : { *(.rodata.__func__.4481) }
.rodata.__func__.4559 0xd924 : { *(.rodata.__func__.4559) }
.rodata.__func__.4554 0xd938 : { *(.rodata.__func__.4554) }
.rodata.__func__.4998 0xd944 : { *(.rodata.__func__.4998) }
.rodata.__func__.5209 0xd950 : { *(.rodata.__func__.5209) }
.rodata.__func__.5853 0xd960 : { *(.rodata.__func__.5853) }
.rodata.__func__.6224 0xd96c : { *(.rodata.__func__.6224) }
.rodata.__func__.5845 0xd97c : { *(.rodata.__func__.5845) }
.rodata.__func__.5849 0xd98c : { *(.rodata.__func__.5849) }
.rodata.__func__.5710 0xd99c : { *(.rodata.__func__.5710) }
.rodata.__func__.5717 0xd9ac : { *(.rodata.__func__.5717) }
.rodata.__func__.5702 0xd9bc : { *(.rodata.__func__.5702) }
.rodata.__func__.4631 0xd9c8 : { *(.rodata.__func__.4631) }
.rodata.__func__.4642 0xd9d8 : { *(.rodata.__func__.4642) }
.rodata.__func__.4647 0xd9e8 : { *(.rodata.__func__.4647) }
.rodata.__func__.4660 0xd9f8 : { *(.rodata.__func__.4660) }
.rodata.__func__.4665 0xda08 : { *(.rodata.__func__.4665) }
.rodata.__func__.4675 0xda18 : { *(.rodata.__func__.4675) }
.rodata.__func__.4683 0xda28 : { *(.rodata.__func__.4683) }
.rodata.__func__.4687 0xda38 : { *(.rodata.__func__.4687) }
.rodata.__func__.4702 0xda48 : { *(.rodata.__func__.4702) }
.rodata.__func__.4707 0xda58 : { *(.rodata.__func__.4707) }
.rodata.__func__.4712 0xda68 : { *(.rodata.__func__.4712) }
.rodata.__func__.4716 0xda78 : { *(.rodata.__func__.4716) }
.rodata.__func__.4749 0xda88 : { *(.rodata.__func__.4749) }
.rodata.__func__.5293 0xda98 : { *(.rodata.__func__.5293) }
.rodata.__func__.5297 0xdaa8 : { *(.rodata.__func__.5297) }
.rodata.__func__.5308 0xdab8 : { *(.rodata.__func__.5308) }
.rodata.__func__.5403 0xdac4 : { *(.rodata.__func__.5403) }
.rodata.__func__.5354 0xdad0 : { *(.rodata.__func__.5354) }
.rodata.__func__.5399 0xdadc : { *(.rodata.__func__.5399) }
.rodata.__func__.5467 0xdae8 : { *(.rodata.__func__.5467) }
.rodata.__func__.5463 0xdaf4 : { *(.rodata.__func__.5463) }
.rodata.__func__.5560 0xdb00 : { *(.rodata.__func__.5560) }
.rodata.__func__.5568 0xdb0c : { *(.rodata.__func__.5568) }
.rodata.__func__.5577 0xdb18 : { *(.rodata.__func__.5577) }
.rodata.__func__.5587 0xdb24 : { *(.rodata.__func__.5587) }
.rodata.__func__.5595 0xdb30 : { *(.rodata.__func__.5595) }
.rodata.__func__.6040 0xdb3c : { *(.rodata.__func__.6040) }
.rodata.__func__.6060 0xdb4c : { *(.rodata.__func__.6060) }
.rodata.__func__.6087 0xdb5c : { *(.rodata.__func__.6087) }
.rodata.__func__.6128 0xdb6c : { *(.rodata.__func__.6128) }
.data16./home/jordanr/volume1/dolphin_12012016/SageBios_Mohon_Peak/coreboot/payloads/seabios/src/mouse.c.106 0xdb7c : { *(.data16./home/jordanr/volume1/dolphin_12012016/SageBios_Mohon_Peak/coreboot/payloads/seabios/src/mouse.c.106) }
.data16./home/jordanr/volume1/dolphin_12012016/SageBios_Mohon_Peak/coreboot/payloads/seabios/src/hw/usb-hid.c.142 0xdb84 : { *(.data16./home/jordanr/volume1/dolphin_12012016/SageBios_Mohon_Peak/coreboot/payloads/seabios/src/hw/usb-hid.c.142) }
.data16./home/jordanr/volume1/dolphin_12012016/SageBios_Mohon_Peak/coreboot/payloads/seabios/src/kbd.c.292 0xdc4c : { *(.data16./home/jordanr/volume1/dolphin_12012016/SageBios_Mohon_Peak/coreboot/payloads/seabios/src/kbd.c.292) }
.data16./home/jordanr/volume1/dolphin_12012016/SageBios_Mohon_Peak/coreboot/payloads/seabios/src/hw/usb-hid.c.159 0xdfc8 : { *(.data16./home/jordanr/volume1/dolphin_12012016/SageBios_Mohon_Peak/coreboot/payloads/seabios/src/hw/usb-hid.c.159) }
.data16./home/jordanr/volume1/dolphin_12012016/SageBios_Mohon_Peak/coreboot/payloads/seabios/src/serial.c.331 0xdfd8 : { *(.data16./home/jordanr/volume1/dolphin_12012016/SageBios_Mohon_Peak/coreboot/payloads/seabios/src/serial.c.331) }
.fixedaddr.0xe05b 0xe05b : { *(.fixedaddr.0xe05b) }
.fixedaddr.0xe2c3 0xe2c3 : { *(.fixedaddr.0xe2c3) }
.fixedaddr.0xe3fe 0xe3fe : { *(.fixedaddr.0xe3fe) }
.fixedaddr.0xe6f2 0xe6f2 : { *(.fixedaddr.0xe6f2) }
.fixedaddr.0xe739 0xe739 : { *(.fixedaddr.0xe739) }
.fixedaddr.0xe82e 0xe82e : { *(.fixedaddr.0xe82e) }
.fixedaddr.0xe987 0xe987 : { *(.fixedaddr.0xe987) }
.fixedaddr.0xec59 0xec59 : { *(.fixedaddr.0xec59) }
.fixedaddr.0xef57 0xef57 : { *(.fixedaddr.0xef57) }
.fixedaddr.0xefd2 0xefd2 : { *(.fixedaddr.0xefd2) }
.fixedaddr.0xf045 0xf045 : { *(.fixedaddr.0xf045) }
.fixedaddr.0xf065 0xf065 : { *(.fixedaddr.0xf065) }
.fixedaddr.0xf841 0xf841 : { *(.fixedaddr.0xf841) }
.fixedaddr.0xf84d 0xf84d : { *(.fixedaddr.0xf84d) }
.fixedaddr.0xf859 0xf859 : { *(.fixedaddr.0xf859) }
.fixedaddr.0xfe6e 0xfe6e : { *(.fixedaddr.0xfe6e) }
.fixedaddr.0xfea5 0xfea5 : { *(.fixedaddr.0xfea5) }
.fixedaddr.0xff53 0xff53 : { *(.fixedaddr.0xff53) }
.fixedaddr.0xff54 0xff54 : { *(.fixedaddr.0xff54) }
.fixedaddr.0xfff0 0xfff0 : { *(.fixedaddr.0xfff0) }



        /* Discard regular data sections to force a link error if
         * code attempts to access data not marked with VAR16 (or other
         * appropriate macro)
         */
        /DISCARD/ : {
                *(.text*) *(.data*) *(.bss*) *(.rodata*)
                *(COMMON) *(.discard*) *(.eh_frame) *(.note*)
                }
}
