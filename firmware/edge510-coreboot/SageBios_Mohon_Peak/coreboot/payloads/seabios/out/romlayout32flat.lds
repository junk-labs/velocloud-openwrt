
/* DO NOT EDIT!  This is an autogenerated file.  See scripts/layoutrom.py. */
OUTPUT_FORMAT("elf32-i386")
OUTPUT_ARCH("i386")
SECTIONS
{
emulated_drive_gf = 0x9f7c8 ;
Century = 0x9f7c5 ;
ExtraStack = 0x9f7f8 ;
BootSequence = 0x9f7b0 ;
StackPos = 0x9f7f4 ;
CDEmu = 0x9f7cc ;
HaveAttemptedReboot = 0x9f7c4 ;
StackSeg = 0x9f7f0 ;
CDRom_locks = 0x9f7e0 ;
LastUSBkey = 0x9f7b4 ;
RTCusers = 0x9f7bc ;
TimerLast = 0x9f7c0 ;
entry_15_official = 0xff859 ;
_cfunc16_check_irqs = 0xf9b51 ;
entry_13_official = 0xfe3fe ;
irq_trampoline_0x16 = 0xfcefa ;
irq_trampoline_0x13 = 0xfcef4 ;
entry_1a_official = 0xffe6e ;
irq_trampoline_0x10 = 0xfcef1 ;
entry_17 = 0xfefd2 ;
irq_trampoline_0x19 = 0xff83d ;
irq_trampoline_0x18 = 0xfcefd ;
entry_iret_official = 0xfff53 ;
entry_08 = 0xffea5 ;
entry_pnp_real = 0xfcf62 ;
entry_19_official = 0xfe6f2 ;
entry_40 = 0xfec59 ;
entry_02 = 0xfe2c3 ;
entry_hwpic2 = 0xfd222 ;
entry_75 = 0xfd210 ;
_cfunc16_wait_irq = 0xf9b73 ;
reset_vector = 0xffff0 ;
entry_pnp_prot = 0xfcf5e ;
entry_70 = 0xfd207 ;
entry_pmm = 0xfcf15 ;
__call16 = 0xfce9f ;
entry_18 = 0xfd23e ;
entry_bios32 = 0xfd0ab ;
_cfunc16__farcall16 = 0xf9b07 ;
entry_11 = 0xff84d ;
entry_12 = 0xff841 ;
entry_14 = 0xfe739 ;
entry_16 = 0xfe82e ;
entry_elf = 0xfd0ca ;
entry_10 = 0xff065 ;
entry_hwpic1 = 0xfd219 ;
__call16big = 0xfceab ;

    _reloc_min_align = 0x10 ;
    zonefseg_start = 0xf0000 ;
    zonefseg_end = 0xf43d0 ;
    zonelow_base = 0x90000 ;
    final_varlow_start = 0x9f7b0 ;
    final_readonly_start = 0xf0000 ;
    varlow_start = 0xecd20 ;
    varlow_end = 0xed570 ;
    code32init_start = 0xed570 ;
    code32init_end = 0xf43d0 ;

    code32flat_start = 0xec5b8 ;
    .text code32flat_start : {
        _reloc_abs_start = ABSOLUTE(.) ;
LONG(0xed594 - code32init_start)
LONG(0xed7b2 - code32init_start)
LONG(0xed815 - code32init_start)
LONG(0xed81c - code32init_start)
LONG(0xed834 - code32init_start)
LONG(0xed91b - code32init_start)
LONG(0xed924 - code32init_start)
LONG(0xed94a - code32init_start)
LONG(0xed956 - code32init_start)
LONG(0xedb70 - code32init_start)
LONG(0xedd63 - code32init_start)
LONG(0xeded6 - code32init_start)
LONG(0xedf4f - code32init_start)
LONG(0xedf59 - code32init_start)
LONG(0xee10c - code32init_start)
LONG(0xee152 - code32init_start)
LONG(0xee1b8 - code32init_start)
LONG(0xee1e2 - code32init_start)
LONG(0xee1fb - code32init_start)
LONG(0xee267 - code32init_start)
LONG(0xee4d5 - code32init_start)
LONG(0xee550 - code32init_start)
LONG(0xee5a2 - code32init_start)
LONG(0xee5e4 - code32init_start)
LONG(0xee659 - code32init_start)
LONG(0xee81b - code32init_start)
LONG(0xee83e - code32init_start)
LONG(0xee881 - code32init_start)
LONG(0xee89f - code32init_start)
LONG(0xee8b7 - code32init_start)
LONG(0xee99f - code32init_start)
LONG(0xee9b8 - code32init_start)
LONG(0xee9ee - code32init_start)
LONG(0xeea1e - code32init_start)
LONG(0xeea69 - code32init_start)
LONG(0xeea9d - code32init_start)
LONG(0xeeaef - code32init_start)
LONG(0xeeaf4 - code32init_start)
LONG(0xeeb98 - code32init_start)
LONG(0xeebc5 - code32init_start)
LONG(0xeed29 - code32init_start)
LONG(0xeed3a - code32init_start)
LONG(0xeed5a - code32init_start)
LONG(0xeed68 - code32init_start)
LONG(0xeeda7 - code32init_start)
LONG(0xeedb7 - code32init_start)
LONG(0xeedef - code32init_start)
LONG(0xeee69 - code32init_start)
LONG(0xeee7b - code32init_start)
LONG(0xeeec4 - code32init_start)
LONG(0xeeee9 - code32init_start)
LONG(0xeeef9 - code32init_start)
LONG(0xef14d - code32init_start)
LONG(0xef177 - code32init_start)
LONG(0xef189 - code32init_start)
LONG(0xef1d8 - code32init_start)
LONG(0xef23c - code32init_start)
LONG(0xef295 - code32init_start)
LONG(0xef2e9 - code32init_start)
LONG(0xef30b - code32init_start)
LONG(0xef399 - code32init_start)
LONG(0xef3f2 - code32init_start)
LONG(0xef4f7 - code32init_start)
LONG(0xef53c - code32init_start)
LONG(0xef5b0 - code32init_start)
LONG(0xef66e - code32init_start)
LONG(0xef6b1 - code32init_start)
LONG(0xef6c1 - code32init_start)
LONG(0xef76b - code32init_start)
LONG(0xef7b9 - code32init_start)
LONG(0xef857 - code32init_start)
LONG(0xef883 - code32init_start)
LONG(0xef893 - code32init_start)
LONG(0xefa5f - code32init_start)
LONG(0xefa79 - code32init_start)
LONG(0xefad6 - code32init_start)
LONG(0xefb21 - code32init_start)
LONG(0xefb65 - code32init_start)
LONG(0xefb86 - code32init_start)
LONG(0xefd27 - code32init_start)
LONG(0xefdf3 - code32init_start)
LONG(0xefe11 - code32init_start)
LONG(0xefe2f - code32init_start)
LONG(0xefe47 - code32init_start)
LONG(0xeff6d - code32init_start)
LONG(0xeff7e - code32init_start)
LONG(0xeff8e - code32init_start)
LONG(0xf0025 - code32init_start)
LONG(0xf0035 - code32init_start)
LONG(0xf0089 - code32init_start)
LONG(0xf0169 - code32init_start)
LONG(0xf021a - code32init_start)
LONG(0xf0250 - code32init_start)
LONG(0xf0287 - code32init_start)
LONG(0xf02c1 - code32init_start)
LONG(0xf0328 - code32init_start)
LONG(0xf0350 - code32init_start)
LONG(0xf0371 - code32init_start)
LONG(0xf03aa - code32init_start)
LONG(0xf043f - code32init_start)
LONG(0xf0475 - code32init_start)
LONG(0xf04f1 - code32init_start)
LONG(0xf0519 - code32init_start)
LONG(0xf0600 - code32init_start)
LONG(0xf06e2 - code32init_start)
LONG(0xf0747 - code32init_start)
LONG(0xf079c - code32init_start)
LONG(0xf07af - code32init_start)
LONG(0xf07c0 - code32init_start)
LONG(0xf0943 - code32init_start)
LONG(0xf0a39 - code32init_start)
LONG(0xf0a3f - code32init_start)
LONG(0xf0b5b - code32init_start)
LONG(0xf0b76 - code32init_start)
LONG(0xf0bec - code32init_start)
LONG(0xf0d12 - code32init_start)
LONG(0xf0d25 - code32init_start)
LONG(0xf0e63 - code32init_start)
LONG(0xf12ea - code32init_start)
LONG(0xf158a - code32init_start)
LONG(0xf17dd - code32init_start)
LONG(0xf1888 - code32init_start)
LONG(0xf18ba - code32init_start)
LONG(0xf18d7 - code32init_start)
LONG(0xf19b2 - code32init_start)
LONG(0xf1a0d - code32init_start)
LONG(0xf1a6b - code32init_start)
LONG(0xf1c21 - code32init_start)
LONG(0xf1ecb - code32init_start)
LONG(0xf2000 - code32init_start)
LONG(0xf2029 - code32init_start)
LONG(0xf2070 - code32init_start)
LONG(0xf2099 - code32init_start)
LONG(0xf213c - code32init_start)
LONG(0xf218b - code32init_start)
LONG(0xf21f6 - code32init_start)
LONG(0xf21fe - code32init_start)
LONG(0xf22a1 - code32init_start)
LONG(0xf22e5 - code32init_start)
LONG(0xf22ed - code32init_start)
LONG(0xf2540 - code32init_start)
LONG(0xf2589 - code32init_start)
LONG(0xf2596 - code32init_start)
LONG(0xf259f - code32init_start)
LONG(0xf25b3 - code32init_start)
LONG(0xf25cc - code32init_start)
LONG(0xf2a1a - code32init_start)
LONG(0xf2ac2 - code32init_start)
LONG(0xf2b4f - code32init_start)
LONG(0xf2c30 - code32init_start)
LONG(0xf2c68 - code32init_start)
LONG(0xf2cd0 - code32init_start)
LONG(0xf2d00 - code32init_start)
LONG(0xf2e1c - code32init_start)
LONG(0xf2e2f - code32init_start)
LONG(0xf2e57 - code32init_start)
LONG(0xf2ee2 - code32init_start)
LONG(0xf2ef2 - code32init_start)
LONG(0xf2f3d - code32init_start)
LONG(0xf2f85 - code32init_start)
LONG(0xf3137 - code32init_start)
LONG(0xf335a - code32init_start)
LONG(0xf3380 - code32init_start)
LONG(0xf33b5 - code32init_start)
LONG(0xf372c - code32init_start)
LONG(0xf376e - code32init_start)
LONG(0xf378f - code32init_start)
LONG(0xf37f9 - code32init_start)
LONG(0xf3839 - code32init_start)
LONG(0xf386d - code32init_start)
LONG(0xf3882 - code32init_start)
LONG(0xf3a7f - code32init_start)
LONG(0xf3b23 - code32init_start)
LONG(0xf3b6f - code32init_start)
LONG(0xf3b7c - code32init_start)
LONG(0xf3c56 - code32init_start)
LONG(0xf3c8c - code32init_start)
LONG(0xf3ca5 - code32init_start)
LONG(0xf3d70 - code32init_start)
LONG(0xf3dfa - code32init_start)
LONG(0xf3dff - code32init_start)
LONG(0xf3e06 - code32init_start)
LONG(0xf3e0b - code32init_start)
LONG(0xf3efd - code32init_start)
LONG(0xf4324 - code32init_start)
LONG(0xf4328 - code32init_start)
LONG(0xf432c - code32init_start)
LONG(0xf4330 - code32init_start)
LONG(0xf4334 - code32init_start)
LONG(0xf435c - code32init_start)
LONG(0xf4360 - code32init_start)
LONG(0xf4364 - code32init_start)
LONG(0xf4368 - code32init_start)
LONG(0xf436c - code32init_start)
LONG(0xf4370 - code32init_start)
LONG(0xf4378 - code32init_start)
LONG(0xf437c - code32init_start)
LONG(0xf4380 - code32init_start)
        _reloc_abs_end = ABSOLUTE(.) ;
        _reloc_rel_start = ABSOLUTE(.) ;
LONG(0xed5de - code32init_start)
LONG(0xedbc7 - code32init_start)
LONG(0xedd7c - code32init_start)
LONG(0xedf29 - code32init_start)
LONG(0xedf4a - code32init_start)
LONG(0xedf84 - code32init_start)
LONG(0xee104 - code32init_start)
LONG(0xee131 - code32init_start)
LONG(0xee505 - code32init_start)
LONG(0xee524 - code32init_start)
LONG(0xee53c - code32init_start)
LONG(0xee547 - code32init_start)
LONG(0xee55a - code32init_start)
LONG(0xee564 - code32init_start)
LONG(0xee61c - code32init_start)
LONG(0xee62c - code32init_start)
LONG(0xee649 - code32init_start)
LONG(0xee650 - code32init_start)
LONG(0xee663 - code32init_start)
LONG(0xee66a - code32init_start)
LONG(0xee681 - code32init_start)
LONG(0xee68f - code32init_start)
LONG(0xee6a4 - code32init_start)
LONG(0xee6e3 - code32init_start)
LONG(0xee7a5 - code32init_start)
LONG(0xee7d4 - code32init_start)
LONG(0xee96d - code32init_start)
LONG(0xee9d6 - code32init_start)
LONG(0xeeaea - code32init_start)
LONG(0xeeb5b - code32init_start)
LONG(0xeeb69 - code32init_start)
LONG(0xeebde - code32init_start)
LONG(0xeed17 - code32init_start)
LONG(0xeedcd - code32init_start)
LONG(0xeef12 - code32init_start)
LONG(0xeef3f - code32init_start)
LONG(0xeef91 - code32init_start)
LONG(0xeefca - code32init_start)
LONG(0xeefdf - code32init_start)
LONG(0xef019 - code32init_start)
LONG(0xef08d - code32init_start)
LONG(0xef0a2 - code32init_start)
LONG(0xef0d2 - code32init_start)
LONG(0xef0e0 - code32init_start)
LONG(0xef10d - code32init_start)
LONG(0xef138 - code32init_start)
LONG(0xef159 - code32init_start)
LONG(0xef1a4 - code32init_start)
LONG(0xef258 - code32init_start)
LONG(0xef25f - code32init_start)
LONG(0xef288 - code32init_start)
LONG(0xef2cd - code32init_start)
LONG(0xef2ff - code32init_start)
LONG(0xef31c - code32init_start)
LONG(0xef3b9 - code32init_start)
LONG(0xef3c6 - code32init_start)
LONG(0xef3d3 - code32init_start)
LONG(0xef3e0 - code32init_start)
LONG(0xef3fe - code32init_start)
LONG(0xef503 - code32init_start)
LONG(0xef59d - code32init_start)
LONG(0xef5cc - code32init_start)
LONG(0xef691 - code32init_start)
LONG(0xef6a8 - code32init_start)
LONG(0xef6bb - code32init_start)
LONG(0xef6cb - code32init_start)
LONG(0xef6e0 - code32init_start)
LONG(0xef729 - code32init_start)
LONG(0xef7a6 - code32init_start)
LONG(0xef7eb - code32init_start)
LONG(0xef851 - code32init_start)
LONG(0xef8ac - code32init_start)
LONG(0xef96d - code32init_start)
LONG(0xefa07 - code32init_start)
LONG(0xefa1d - code32init_start)
LONG(0xefa42 - code32init_start)
LONG(0xefaef - code32init_start)
LONG(0xefb50 - code32init_start)
LONG(0xefb80 - code32init_start)
LONG(0xefb9f - code32init_start)
LONG(0xefbd1 - code32init_start)
LONG(0xefc4e - code32init_start)
LONG(0xefcc2 - code32init_start)
LONG(0xefcda - code32init_start)
LONG(0xefd37 - code32init_start)
LONG(0xefe72 - code32init_start)
LONG(0xefe7d - code32init_start)
LONG(0xefe88 - code32init_start)
LONG(0xeffa7 - code32init_start)
LONG(0xf004e - code32init_start)
LONG(0xf0175 - code32init_start)
LONG(0xf0293 - code32init_start)
LONG(0xf02cd - code32init_start)
LONG(0xf02d8 - code32init_start)
LONG(0xf0334 - code32init_start)
LONG(0xf035c - code32init_start)
LONG(0xf037d - code32init_start)
LONG(0xf044b - code32init_start)
LONG(0xf0481 - code32init_start)
LONG(0xf04fd - code32init_start)
LONG(0xf0525 - code32init_start)
LONG(0xf05af - code32init_start)
LONG(0xf05d4 - code32init_start)
LONG(0xf05f7 - code32init_start)
LONG(0xf060a - code32init_start)
LONG(0xf0639 - code32init_start)
LONG(0xf0653 - code32init_start)
LONG(0xf0686 - code32init_start)
LONG(0xf0694 - code32init_start)
LONG(0xf0703 - code32init_start)
LONG(0xf08e8 - code32init_start)
LONG(0xf09c6 - code32init_start)
LONG(0xf0a23 - code32init_start)
LONG(0xf0a33 - code32init_start)
LONG(0xf0c53 - code32init_start)
LONG(0xf0c72 - code32init_start)
LONG(0xf0c87 - code32init_start)
LONG(0xf0ca3 - code32init_start)
LONG(0xf0cd8 - code32init_start)
LONG(0xf0ceb - code32init_start)
LONG(0xf0d3f - code32init_start)
LONG(0xf0d95 - code32init_start)
LONG(0xf0e7c - code32init_start)
LONG(0xf0f4a - code32init_start)
LONG(0xf0f5e - code32init_start)
LONG(0xf0f8d - code32init_start)
LONG(0xf1038 - code32init_start)
LONG(0xf10b3 - code32init_start)
LONG(0xf10c7 - code32init_start)
LONG(0xf10da - code32init_start)
LONG(0xf1103 - code32init_start)
LONG(0xf1114 - code32init_start)
LONG(0xf113e - code32init_start)
LONG(0xf114c - code32init_start)
LONG(0xf117c - code32init_start)
LONG(0xf11dc - code32init_start)
LONG(0xf1226 - code32init_start)
LONG(0xf1276 - code32init_start)
LONG(0xf12be - code32init_start)
LONG(0xf1383 - code32init_start)
LONG(0xf1419 - code32init_start)
LONG(0xf156c - code32init_start)
LONG(0xf15d9 - code32init_start)
LONG(0xf161d - code32init_start)
LONG(0xf1651 - code32init_start)
LONG(0xf176f - code32init_start)
LONG(0xf17ee - code32init_start)
LONG(0xf183c - code32init_start)
LONG(0xf1882 - code32init_start)
LONG(0xf1951 - code32init_start)
LONG(0xf198d - code32init_start)
LONG(0xf1a25 - code32init_start)
LONG(0xf1a32 - code32init_start)
LONG(0xf1a3f - code32init_start)
LONG(0xf1a50 - code32init_start)
LONG(0xf1a64 - code32init_start)
LONG(0xf1a99 - code32init_start)
LONG(0xf1b3e - code32init_start)
LONG(0xf1b56 - code32init_start)
LONG(0xf1b6e - code32init_start)
LONG(0xf1b78 - code32init_start)
LONG(0xf1b88 - code32init_start)
LONG(0xf1ba3 - code32init_start)
LONG(0xf1bb1 - code32init_start)
LONG(0xf1bbe - code32init_start)
LONG(0xf1bda - code32init_start)
LONG(0xf1bed - code32init_start)
LONG(0xf1bf7 - code32init_start)
LONG(0xf1c09 - code32init_start)
LONG(0xf1c18 - code32init_start)
LONG(0xf1c2b - code32init_start)
LONG(0xf1c42 - code32init_start)
LONG(0xf1c4c - code32init_start)
LONG(0xf1c66 - code32init_start)
LONG(0xf1c75 - code32init_start)
LONG(0xf1c93 - code32init_start)
LONG(0xf1cba - code32init_start)
LONG(0xf1cd8 - code32init_start)
LONG(0xf1e10 - code32init_start)
LONG(0xf1e9e - code32init_start)
LONG(0xf1f61 - code32init_start)
LONG(0xf1f77 - code32init_start)
LONG(0xf1f87 - code32init_start)
LONG(0xf1f9f - code32init_start)
LONG(0xf1fb9 - code32init_start)
LONG(0xf200a - code32init_start)
LONG(0xf2020 - code32init_start)
LONG(0xf208a - code32init_start)
LONG(0xf20ce - code32init_start)
LONG(0xf20e3 - code32init_start)
LONG(0xf20eb - code32init_start)
LONG(0xf20f7 - code32init_start)
LONG(0xf2155 - code32init_start)
LONG(0xf216f - code32init_start)
LONG(0xf2193 - code32init_start)
LONG(0xf21a2 - code32init_start)
LONG(0xf21b8 - code32init_start)
LONG(0xf21f1 - code32init_start)
LONG(0xf2206 - code32init_start)
LONG(0xf2242 - code32init_start)
LONG(0xf2258 - code32init_start)
LONG(0xf2274 - code32init_start)
LONG(0xf22e0 - code32init_start)
LONG(0xf230c - code32init_start)
LONG(0xf24af - code32init_start)
LONG(0xf24be - code32init_start)
LONG(0xf24f3 - code32init_start)
LONG(0xf25c5 - code32init_start)
LONG(0xf25dd - code32init_start)
LONG(0xf2605 - code32init_start)
LONG(0xf2615 - code32init_start)
LONG(0xf2648 - code32init_start)
LONG(0xf2685 - code32init_start)
LONG(0xf26c4 - code32init_start)
LONG(0xf26fb - code32init_start)
LONG(0xf272a - code32init_start)
LONG(0xf275a - code32init_start)
LONG(0xf27fa - code32init_start)
LONG(0xf28c9 - code32init_start)
LONG(0xf28d5 - code32init_start)
LONG(0xf2917 - code32init_start)
LONG(0xf292a - code32init_start)
LONG(0xf2933 - code32init_start)
LONG(0xf2a32 - code32init_start)
LONG(0xf2ae2 - code32init_start)
LONG(0xf2b7a - code32init_start)
LONG(0xf2c51 - code32init_start)
LONG(0xf2c80 - code32init_start)
LONG(0xf2ca8 - code32init_start)
LONG(0xf2cf0 - code32init_start)
LONG(0xf2d98 - code32init_start)
LONG(0xf2e06 - code32init_start)
LONG(0xf2e51 - code32init_start)
LONG(0xf2f02 - code32init_start)
LONG(0xf2f10 - code32init_start)
LONG(0xf2f66 - code32init_start)
LONG(0xf2f7f - code32init_start)
LONG(0xf2fc3 - code32init_start)
LONG(0xf3057 - code32init_start)
LONG(0xf30e2 - code32init_start)
LONG(0xf311e - code32init_start)
LONG(0xf31a2 - code32init_start)
LONG(0xf31d1 - code32init_start)
LONG(0xf3214 - code32init_start)
LONG(0xf334e - code32init_start)
LONG(0xf3412 - code32init_start)
LONG(0xf3485 - code32init_start)
LONG(0xf3633 - code32init_start)
LONG(0xf3725 - code32init_start)
LONG(0xf37b1 - code32init_start)
LONG(0xf37d4 - code32init_start)
LONG(0xf37f4 - code32init_start)
LONG(0xf3805 - code32init_start)
LONG(0xf3852 - code32init_start)
LONG(0xf387d - code32init_start)
LONG(0xf38cc - code32init_start)
LONG(0xf38e6 - code32init_start)
LONG(0xf3985 - code32init_start)
LONG(0xf39be - code32init_start)
LONG(0xf3a17 - code32init_start)
LONG(0xf3a49 - code32init_start)
LONG(0xf3a6c - code32init_start)
LONG(0xf3b37 - code32init_start)
LONG(0xf3b51 - code32init_start)
LONG(0xf3b90 - code32init_start)
LONG(0xf3b9e - code32init_start)
LONG(0xf3bca - code32init_start)
LONG(0xf3cf4 - code32init_start)
LONG(0xf3d10 - code32init_start)
LONG(0xf3da5 - code32init_start)
LONG(0xf3dec - code32init_start)
LONG(0xf3eed - code32init_start)
LONG(0xf3f2f - code32init_start)
        _reloc_rel_end = ABSOLUTE(.) ;
        _reloc_init_start = ABSOLUTE(.) ;
LONG(0xf6ed9 - code32flat_start)
LONG(0xfc8b1 - code32flat_start)
LONG(0xfcf2d - code32flat_start)
        _reloc_init_end = ABSOLUTE(.) ;

. = ( 0xecd20 - code32flat_start ) ;
*32flat.*(.data.varlow./home/jordanr/volume1/dolphin_12012016/SageBios_Mohon_Peak/coreboot/payloads/seabios/src/boot.c.846)
. = ( 0xecd24 - code32flat_start ) ;
*32flat.*(.data.varlow./home/jordanr/volume1/dolphin_12012016/SageBios_Mohon_Peak/coreboot/payloads/seabios/src/hw/usb-hid.c.225)
. = ( 0xecd2c - code32flat_start ) ;
*32flat.*(.data.varlow./home/jordanr/volume1/dolphin_12012016/SageBios_Mohon_Peak/coreboot/payloads/seabios/src/hw/rtc.c.71)
. = ( 0xecd30 - code32flat_start ) ;
*32flat.*(.data.varlow./home/jordanr/volume1/dolphin_12012016/SageBios_Mohon_Peak/coreboot/payloads/seabios/src/hw/timer.c.138)
. = ( 0xecd34 - code32flat_start ) ;
*32flat.*(.data.varlow./home/jordanr/volume1/dolphin_12012016/SageBios_Mohon_Peak/coreboot/payloads/seabios/src/resume.c.114)
. = ( 0xecd35 - code32flat_start ) ;
*32flat.*(.data.varlow./home/jordanr/volume1/dolphin_12012016/SageBios_Mohon_Peak/coreboot/payloads/seabios/src/clock.c.29)
. = ( 0xecd38 - code32flat_start ) ;
*32flat.*(.data.varlow./home/jordanr/volume1/dolphin_12012016/SageBios_Mohon_Peak/coreboot/payloads/seabios/src/cdrom.c.28)
. = ( 0xecd3c - code32flat_start ) ;
*32flat.*(.data.varlow./home/jordanr/volume1/dolphin_12012016/SageBios_Mohon_Peak/coreboot/payloads/seabios/src/cdrom.c.27)
. = ( 0xecd50 - code32flat_start ) ;
*32flat.*(.data.varlow./home/jordanr/volume1/dolphin_12012016/SageBios_Mohon_Peak/coreboot/payloads/seabios/src/cdrom.c.20)
. = ( 0xecd60 - code32flat_start ) ;
*32flat.*(.data.varlow./home/jordanr/volume1/dolphin_12012016/SageBios_Mohon_Peak/coreboot/payloads/seabios/src/stacks.c.106)
. = ( 0xecd64 - code32flat_start ) ;
*32flat.*(.data.varlow./home/jordanr/volume1/dolphin_12012016/SageBios_Mohon_Peak/coreboot/payloads/seabios/src/stacks.c.26)
. = ( 0xecd68 - code32flat_start ) ;
*32flat.*(.data.varlow./home/jordanr/volume1/dolphin_12012016/SageBios_Mohon_Peak/coreboot/payloads/seabios/src/stacks.c.25)
. = ( 0xed570 - code32flat_start ) ;
*32flat.*(.text.hlist_del)
. = ( 0xed57f - code32flat_start ) ;
*32flat.*(.text.hlist_add)
. = ( 0xed590 - code32flat_start ) ;
*32flat.*(.text.threads_during_optionroms)
. = ( 0xed5a8 - code32flat_start ) ;
*32flat.*(.text.putc_str)
. = ( 0xed5b6 - code32flat_start ) ;
*32flat.*(.text.strtcpy)
. = ( 0xed5da - code32flat_start ) ;
*32flat.*(.text.nullTrailingSpace)
. = ( 0xed606 - code32flat_start ) ;
*32flat.*(.text.free_pipe)
. = ( 0xed613 - code32flat_start ) ;
*32flat.*(.text.usb_desc2pipe)
. = ( 0xed64e - code32flat_start ) ;
*32flat.*(.text.findEndPointDesc)
. = ( 0xed68c - code32flat_start ) ;
*32flat.*(.text.ehci_hub_disconnect)
. = ( 0xed6a1 - code32flat_start ) ;
*32flat.*(.text.ehci_desc2pipe)
. = ( 0xed743 - code32flat_start ) ;
*32flat.*(.text.allocSpace)
. = ( 0xed790 - code32flat_start ) ;
*32flat.*(.text.freeSpace)
. = ( 0xed7ad - code32flat_start ) ;
*32flat.*(.text.findAlloc)
. = ( 0xed7cc - code32flat_start ) ;
*32flat.*(.text._free)
. = ( 0xed7fb - code32flat_start ) ;
*32flat.*(.text.malloc_getspace)
. = ( 0xed832 - code32flat_start ) ;
*32flat.*(.text.rom_reserve)
. = ( 0xed853 - code32flat_start ) ;
*32flat.*(.text.calcRamSize)
. = ( 0xed8a4 - code32flat_start ) ;
*32flat.*(.text.glob_prefix)
. = ( 0xed905 - code32flat_start ) ;
*32flat.*(.text.add_bev)
. = ( 0xed95d - code32flat_start ) ;
*32flat.*(.text.xhci_hub_detect)
. = ( 0xed96c - code32flat_start ) ;
*32flat.*(.text.xhci_hub_disconnect)
. = ( 0xed96d - code32flat_start ) ;
*32flat.*(.text.ipchksum)
. = ( 0xed9a3 - code32flat_start ) ;
*32flat.*(.text.find_cb_header)
. = ( 0xed9f2 - code32flat_start ) ;
*32flat.*(.text.find_cb_subtable)
. = ( 0xeda17 - code32flat_start ) ;
*32flat.*(.text.smbios_next)
. = ( 0xeda6f - code32flat_start ) ;
*32flat.*(.text.memmove)
. = ( 0xedaac - code32flat_start ) ;
*32flat.*(.text.remove_e820)
. = ( 0xedad7 - code32flat_start ) ;
*32flat.*(.text.checksum_far.isra.1)
. = ( 0xedaea - code32flat_start ) ;
*32flat.*(.text._valid)
. = ( 0xedb29 - code32flat_start ) ;
*32flat.*(.text.ata_extract_model.constprop.61)
. = ( 0xedb4e - code32flat_start ) ;
*32flat.*(.text.pic_irqmask_mask.constprop.86)
. = ( 0xedb67 - code32flat_start ) ;
*32flat.*(.text.__romfile_findprefix)
. = ( 0xedbc3 - code32flat_start ) ;
*32flat.*(.text.romfile_find)
. = ( 0xedbd8 - code32flat_start ) ;
*32flat.*(.text.romfile_loadint)
. = ( 0xedc36 - code32flat_start ) ;
*32flat.*(.text.detect_serial.constprop.74)
. = ( 0xedc96 - code32flat_start ) ;
*32flat.*(.text.pci_next)
. = ( 0xedd03 - code32flat_start ) ;
*32flat.*(.text.pci_config_maskw.constprop.70)
. = ( 0xedd30 - code32flat_start ) ;
*32flat.*(.text.rtc_use)
. = ( 0xedd4e - code32flat_start ) ;
*32flat.*(.text.snprintf)
. = ( 0xedd99 - code32flat_start ) ;
*32flat.*(.text.build_usb_path.isra.33)
. = ( 0xeddea - code32flat_start ) ;
*32flat.*(.text.build_pci_path.constprop.62)
. = ( 0xedebb - code32flat_start ) ;
*32flat.*(.text.xhci_print_port_state)
. = ( 0xedf35 - code32flat_start ) ;
*32flat.*(.text.find_prio)
. = ( 0xedfb3 - code32flat_start ) ;
*32flat.*(.text.getRomPriority)
. = ( 0xee06c - code32flat_start ) ;
*32flat.*(.text.bootprio_find_ata_device.constprop.57)
. = ( 0xee0c9 - code32flat_start ) ;
*32flat.*(.text.is_valid_rom.part.34)
. = ( 0xee11e - code32flat_start ) ;
*32flat.*(.text.__warn_noalloc)
. = ( 0xee139 - code32flat_start ) ;
*32flat.*(.text.deploy_romfile)
. = ( 0xee180 - code32flat_start ) ;
*32flat.*(.text.addSpace)
. = ( 0xee23d - code32flat_start ) ;
*32flat.*(.text.insert_e820)
. = ( 0xee2d1 - code32flat_start ) ;
*32flat.*(.text.add_e820.part.38)
. = ( 0xee4cb - code32flat_start ) ;
*32flat.*(.text.add_drive)
. = ( 0xee4eb - code32flat_start ) ;
*32flat.*(.text.__end_thread)
. = ( 0xee52d - code32flat_start ) ;
*32flat.*(.text.wait_bit)
. = ( 0xee577 - code32flat_start ) ;
*32flat.*(.text.xhci_hub_reset)
. = ( 0xee60e - code32flat_start ) ;
*32flat.*(.text.ahci_port_reset)
. = ( 0xee6ad - code32flat_start ) ;
*32flat.*(.text.ahci_port_release)
. = ( 0xee6db - code32flat_start ) ;
*32flat.*(.text.msleep)
. = ( 0xee6e7 - code32flat_start ) ;
*32flat.*(.text.ehci_hub_reset)
. = ( 0xee727 - code32flat_start ) ;
*32flat.*(.text.ehci_hub_detect)
. = ( 0xee777 - code32flat_start ) ;
*32flat.*(.text.iomemcpy)
. = ( 0xee7bd - code32flat_start ) ;
*32flat.*(.text.wait_preempt)
. = ( 0xee7e7 - code32flat_start ) ;
*32flat.*(.text._malloc)
. = ( 0xee9e6 - code32flat_start ) ;
*32flat.*(.text.malloc_tmphigh)
. = ( 0xee9f7 - code32flat_start ) ;
*32flat.*(.text.romfile_loadfile.constprop.60)
. = ( 0xeea55 - code32flat_start ) ;
*32flat.*(.text.malloc_tmp)
. = ( 0xeea75 - code32flat_start ) ;
*32flat.*(.text.bootentry_add)
. = ( 0xeeb49 - code32flat_start ) ;
*32flat.*(.text.pci_probe_devices)
. = ( 0xeed26 - code32flat_start ) ;
*32flat.*(.text.memalign_high)
. = ( 0xeed32 - code32flat_start ) ;
*32flat.*(.text.malloc_fseg)
. = ( 0xeed43 - code32flat_start ) ;
*32flat.*(.text.create_bounce_buf)
. = ( 0xeed81 - code32flat_start ) ;
*32flat.*(.text.xhci_alloc_inctx)
. = ( 0xeee60 - code32flat_start ) ;
*32flat.*(.text.memalign_tmp)
. = ( 0xeee89 - code32flat_start ) ;
*32flat.*(.text.send_default_control)
. = ( 0xef16a - code32flat_start ) ;
*32flat.*(.text.run_thread)
. = ( 0xef206 - code32flat_start ) ;
*32flat.*(.text.cbfs_copyfile)
. = ( 0xef2bb - code32flat_start ) ;
*32flat.*(.text.usb_enumerate)
. = ( 0xef32b - code32flat_start ) ;
*32flat.*(.text.configure_xhci)
. = ( 0xef622 - code32flat_start ) ;
*32flat.*(.text.configure_ehci)
. = ( 0xef842 - code32flat_start ) ;
*32flat.*(.text.__usb_setup)
. = ( 0xefb95 - code32flat_start ) ;
*32flat.*(.text.finish_preempt)
. = ( 0xefbcb - code32flat_start ) ;
*32flat.*(.text.mutex_lock)
. = ( 0xefbe2 - code32flat_start ) ;
*32flat.*(.text.get_port_status)
. = ( 0xefc2f - code32flat_start ) ;
*32flat.*(.text.usb_hub_detect)
. = ( 0xefc63 - code32flat_start ) ;
*32flat.*(.text.set_port_feature)
. = ( 0xefca7 - code32flat_start ) ;
*32flat.*(.text.xhci_cmd_submit)
. = ( 0xefcee - code32flat_start ) ;
*32flat.*(.text.xhci_cmd_configure_endpoint)
. = ( 0xefd4d - code32flat_start ) ;
*32flat.*(.text.usb_alloc_pipe)
. = ( 0xf03ed - code32flat_start ) ;
*32flat.*(.text.usb_update_pipe)
. = ( 0xf0556 - code32flat_start ) ;
*32flat.*(.text.usb_hub_disconnect)
. = ( 0xf05b9 - code32flat_start ) ;
*32flat.*(.text.usb_hub_reset)
. = ( 0xf0650 - code32flat_start ) ;
*32flat.*(.text.wait_threads)
. = ( 0xf0664 - code32flat_start ) ;
*32flat.*(.text.__callrom)
. = ( 0xf0713 - code32flat_start ) ;
*32flat.*(.text.init_optionrom)
. = ( 0xf07cc - code32flat_start ) ;
*32flat.*(.text.init_pcirom)
. = ( 0xf09b7 - code32flat_start ) ;
*32flat.*(.text.run_file_roms)
. = ( 0xf0a0c - code32flat_start ) ;
*32flat.*(.text.optionrom_setup)
. = ( 0xf0bfe - code32flat_start ) ;
*32flat.*(.text.get_keystroke)
. = ( 0xf0cfd - code32flat_start ) ;
*32flat.*(.text.znprintf.constprop.84)
. = ( 0xf0d5c - code32flat_start ) ;
*32flat.*(.text.usb_msc_setup)
. = ( 0xf124a - code32flat_start ) ;
*32flat.*(.text.usb_hub_port_setup)
. = ( 0xf17d0 - code32flat_start ) ;
*32flat.*(.text.device_hardware_setup)
. = ( 0xf1b22 - code32flat_start ) ;
*32flat.*(.text.ahci_port_setup)
. = ( 0xf1e86 - code32flat_start ) ;
*32flat.*(.text.ahci_port_detect)
. = ( 0xf1ffe - code32flat_start ) ;
*32flat.*(.text.init./home/jordanr/volume1/dolphin_12012016/SageBios_Mohon_Peak/coreboot/payloads/seabios/src/stacks.c.518)
. = ( 0xf200e - code32flat_start ) ;
*32flat.*(.text.maininit)
. = ( 0xf3a08 - code32flat_start ) ;
*32flat.*(.text.init./home/jordanr/volume1/dolphin_12012016/SageBios_Mohon_Peak/coreboot/payloads/seabios/src/post.c.342)
. = ( 0xf3d8a - code32flat_start ) ;
*32flat.*(.text.init./home/jordanr/volume1/dolphin_12012016/SageBios_Mohon_Peak/coreboot/payloads/seabios/src/pmm.c.120)
. = ( 0xf3f4c - code32flat_start ) ;
*32flat.*(.rodata.__func__.9347)
. = ( 0xf3f58 - code32flat_start ) ;
*32flat.*(.rodata.__func__.11937)
. = ( 0xf3f6c - code32flat_start ) ;
*32flat.*(.rodata.__func__.11908)
. = ( 0xf3f7c - code32flat_start ) ;
*32flat.*(.rodata.__func__.11924)
. = ( 0xf3f90 - code32flat_start ) ;
*32flat.*(.rodata.__func__.9634)
. = ( 0xf3fa4 - code32flat_start ) ;
*32flat.*(.rodata.__func__.9209)
. = ( 0xf3fb0 - code32flat_start ) ;
*32flat.*(.rodata.__func__.9829)
. = ( 0xf3fc0 - code32flat_start ) ;
*32flat.*(.rodata.__func__.5186)
. = ( 0xf3fd4 - code32flat_start ) ;
*32flat.*(.rodata.__func__.12776)
. = ( 0xf3fe0 - code32flat_start ) ;
*32flat.*(.rodata.__func__.12786)
. = ( 0xf3ff0 - code32flat_start ) ;
*32flat.*(.rodata.__func__.12799)
. = ( 0xf4000 - code32flat_start ) ;
*32flat.*(.rodata.__func__.12869)
. = ( 0xf400c - code32flat_start ) ;
*32flat.*(.rodata.__func__.9711)
. = ( 0xf401c - code32flat_start ) ;
*32flat.*(.rodata.__func__.9744)
. = ( 0xf4028 - code32flat_start ) ;
*32flat.*(.rodata.__func__.9693)
. = ( 0xf4038 - code32flat_start ) ;
*32flat.*(.rodata.__func__.9479)
. = ( 0xf4044 - code32flat_start ) ;
*32flat.*(.rodata.__func__.11350)
. = ( 0xf405c - code32flat_start ) ;
*32flat.*(.rodata.__func__.11336)
. = ( 0xf406c - code32flat_start ) ;
*32flat.*(.rodata.speed_from_xhci)
. = ( 0xf40ac - code32flat_start ) ;
*32flat.*(.rodata.__func__.11317)
. = ( 0xf40bc - code32flat_start ) ;
*32flat.*(.rodata.speed_name)
. = ( 0xf40fc - code32flat_start ) ;
*32flat.*(.rodata.__func__.6178)
. = ( 0xf410c - code32flat_start ) ;
*32flat.*(.rodata.speed_to_ctlsize)
. = ( 0xf411c - code32flat_start ) ;
*32flat.*(.rodata.__func__.6793)
. = ( 0xf412c - code32flat_start ) ;
*32flat.*(.rodata.__func__.6767)
. = ( 0xf4144 - code32flat_start ) ;
*32flat.*(.rodata.__func__.11547)
. = ( 0xf4154 - code32flat_start ) ;
*32flat.*(.rodata.__func__.11512)
. = ( 0xf4168 - code32flat_start ) ;
*32flat.*(.rodata.speed_to_xhci)
. = ( 0xf4178 - code32flat_start ) ;
*32flat.*(.rodata.__func__.11536)
. = ( 0xf4188 - code32flat_start ) ;
*32flat.*(.rodata.__func__.11460)
. = ( 0xf41a0 - code32flat_start ) ;
*32flat.*(.rodata.__func__.11468)
. = ( 0xf41b8 - code32flat_start ) ;
*32flat.*(.rodata.__func__.11475)
. = ( 0xf41d4 - code32flat_start ) ;
*32flat.*(.rodata.__func__.11590)
. = ( 0xf41e4 - code32flat_start ) ;
*32flat.*(.rodata.__func__.6834)
. = ( 0xf41f4 - code32flat_start ) ;
*32flat.*(.rodata.__func__.11570)
. = ( 0xf4208 - code32flat_start ) ;
*32flat.*(.rodata.__func__.11482)
. = ( 0xf4224 - code32flat_start ) ;
*32flat.*(.rodata.__func__.11665)
. = ( 0xf4234 - code32flat_start ) ;
*32flat.*(.rodata.__func__.7073)
. = ( 0xf4248 - code32flat_start ) ;
*32flat.*(.rodata.__func__.9942)
. = ( 0xf4258 - code32flat_start ) ;
*32flat.*(.rodata.__func__.2619)
. = ( 0xf4264 - code32flat_start ) ;
*32flat.*(.rodata.__func__.11285)
. = ( 0xf4270 - code32flat_start ) ;
*32flat.*(.rodata.__func__.6726)
. = ( 0xf4288 - code32flat_start ) ;
*32flat.*(.rodata.__func__.6707)
. = ( 0xf4298 - code32flat_start ) ;
*32flat.*(.rodata.__func__.10955)
. = ( 0xf42b0 - code32flat_start ) ;
*32flat.*(.rodata.__func__.10902)
. = ( 0xf42c0 - code32flat_start ) ;
*32flat.*(.rodata.__func__.10935)
. = ( 0xf42d0 - code32flat_start ) ;
*32flat.*(.rodata.__func__.10918)
. = ( 0xf42e4 - code32flat_start ) ;
*32flat.*(.rodata.__func__.3429)
. = ( 0xf42f8 - code32flat_start ) ;
*32flat.*(.rodata.__func__.10909)
. = ( 0xf4308 - code32flat_start ) ;
*32flat.*(.rodata.__func__.3481)
. = ( 0xf4314 - code32flat_start ) ;
*32flat.*(.rodata.__func__.3649)
. = ( 0xf4324 - code32flat_start ) ;
*32flat.*(.data.varinit./home/jordanr/volume1/dolphin_12012016/SageBios_Mohon_Peak/coreboot/payloads/seabios/src/malloc.c.39)
. = ( 0xf4338 - code32flat_start ) ;
*32flat.*(.data.varinit./home/jordanr/volume1/dolphin_12012016/SageBios_Mohon_Peak/coreboot/payloads/seabios/src/malloc.c.35)
. = ( 0xf4340 - code32flat_start ) ;
*32flat.*(.data.varinit./home/jordanr/volume1/dolphin_12012016/SageBios_Mohon_Peak/coreboot/payloads/seabios/src/malloc.c.36)
. = ( 0xf4344 - code32flat_start ) ;
*32flat.*(.data.varinit./home/jordanr/volume1/dolphin_12012016/SageBios_Mohon_Peak/coreboot/payloads/seabios/src/malloc.c.37)
. = ( 0xf434c - code32flat_start ) ;
*32flat.*(.data.varinit./home/jordanr/volume1/dolphin_12012016/SageBios_Mohon_Peak/coreboot/payloads/seabios/src/romfile.c.13)
. = ( 0xf4350 - code32flat_start ) ;
*32flat.*(.data.varinit./home/jordanr/volume1/dolphin_12012016/SageBios_Mohon_Peak/coreboot/payloads/seabios/src/boot.c.30)
. = ( 0xf4354 - code32flat_start ) ;
*32flat.*(.data.varinit./home/jordanr/volume1/dolphin_12012016/SageBios_Mohon_Peak/coreboot/payloads/seabios/src/hw/pci.c.89)
. = ( 0xf4358 - code32flat_start ) ;
*32flat.*(.data.RomEnd)
. = ( 0xf435c - code32flat_start ) ;
*32flat.*(.data.xhci_hub_ops)
. = ( 0xf4368 - code32flat_start ) ;
*32flat.*(.data.HubOp)
. = ( 0xf4374 - code32flat_start ) ;
*32flat.*(.data.varinit./home/jordanr/volume1/dolphin_12012016/SageBios_Mohon_Peak/coreboot/payloads/seabios/src/boot.c.336)
. = ( 0xf4378 - code32flat_start ) ;
*32flat.*(.data.ehci_HubOp)
. = ( 0xf4384 - code32flat_start ) ;
*32flat.*(.data.DefaultBEVPrio)
. = ( 0xf4388 - code32flat_start ) ;
*32flat.*(.data.CBvendor)
. = ( 0xf438c - code32flat_start ) ;
*32flat.*(.data.CBpart)
. = ( 0xf4390 - code32flat_start ) ;
*32flat.*(.bss.PreemptCount)
. = ( 0xf4394 - code32flat_start ) ;
*32flat.*(.bss.ThreadControl)
. = ( 0xf4398 - code32flat_start ) ;
*32flat.*(.bss.BootorderCount)
. = ( 0xf439c - code32flat_start ) ;
*32flat.*(.bss.CBMemTable)
. = ( 0xf43a0 - code32flat_start ) ;
*32flat.*(.bss.SMBiosAddr)
. = ( 0xf43a4 - code32flat_start ) ;
*32flat.*(.bss.EnforceChecksum)
. = ( 0xf43a8 - code32flat_start ) ;
*32flat.*(.bss.S3ResumeVga)
. = ( 0xf43ac - code32flat_start ) ;
*32flat.*(.bss.VgaROM)
. = ( 0xf43b0 - code32flat_start ) ;
*32flat.*(.bss.PendingEHCI)
. = ( 0xf43b4 - code32flat_start ) ;
*32flat.*(.bss.CDCount)
. = ( 0xf43b8 - code32flat_start ) ;
*32flat.*(.bss.HaveFDBoot)
. = ( 0xf43bc - code32flat_start ) ;
*32flat.*(.bss.HardDrive_num)
. = ( 0xf43c0 - code32flat_start ) ;
*32flat.*(.bss.cbcon)
. = ( 0xf43d0 - code32flat_start ) ;
*32flat.*(.text.switch_next)
. = ( 0xf43ed - code32flat_start ) ;
*32flat.*(.text.putc)
. = ( 0xf43f2 - code32flat_start ) ;
*32flat.*(.text.putsinglehex)
. = ( 0xf4405 - code32flat_start ) ;
*32flat.*(.text.puthex)
. = ( 0xf4488 - code32flat_start ) ;
*32flat.*(.text.putprettyhex)
. = ( 0xf44cd - code32flat_start ) ;
*32flat.*(.text.strlen)
. = ( 0xf44dc - code32flat_start ) ;
*32flat.*(.text.memcmp)
. = ( 0xf4500 - code32flat_start ) ;
*32flat.*(.text.strcmp)
. = ( 0xf4520 - code32flat_start ) ;
*32flat.*(.text.strchr)
. = ( 0xf4531 - code32flat_start ) ;
*32flat.*(.text.serial_debug)
. = ( 0xf4552 - code32flat_start ) ;
*32flat.*(.text.serial_debug_flush)
. = ( 0xf456a - code32flat_start ) ;
*32flat.*(.text.fillTDbuffer)
. = ( 0xf45cb - code32flat_start ) ;
*32flat.*(.text.ahci_port_readl)
. = ( 0xf45db - code32flat_start ) ;
*32flat.*(.text.ahci_port_writel)
. = ( 0xf45ef - code32flat_start ) ;
*32flat.*(.text.xhci_trb_queue)
. = ( 0xf4670 - code32flat_start ) ;
*32flat.*(.text.be32_to_cpu)
. = ( 0xf4673 - code32flat_start ) ;
*32flat.*(.text.memset.constprop.88)
. = ( 0xf467f - code32flat_start ) ;
*32flat.*(.text.xhci_xfer_normal)
. = ( 0xf46d0 - code32flat_start ) ;
*32flat.*(.text.timer_read)
. = ( 0xf4752 - code32flat_start ) ;
*32flat.*(.text.timer_check)
. = ( 0xf4766 - code32flat_start ) ;
*32flat.*(.text.timer_delay)
. = ( 0xf4781 - code32flat_start ) ;
*32flat.*(.text.timer_calc)
. = ( 0xf4794 - code32flat_start ) ;
*32flat.*(.text.debug_putc)
. = ( 0xf47af - code32flat_start ) ;
*32flat.*(.text.putuint)
. = ( 0xf47f8 - code32flat_start ) ;
*32flat.*(.text.bvprintf)
. = ( 0xf49f7 - code32flat_start ) ;
*32flat.*(.text.printf)
. = ( 0xf4a18 - code32flat_start ) ;
*32flat.*(.text.__dprintf)
. = ( 0xf4a87 - code32flat_start ) ;
*32flat.*(.text.ulzma)
. = ( 0xf54d6 - code32flat_start ) ;
*32flat.*(.text.xhci_process_events)
. = ( 0xf55db - code32flat_start ) ;
*32flat.*(.text.__warn_timeout)
. = ( 0xf55f6 - code32flat_start ) ;
*32flat.*(.text.load_vxworks32_bootrom)
. = ( 0xf569c - code32flat_start ) ;
*32flat.*(.text.panic)
. = ( 0xf56b7 - code32flat_start ) ;
*32flat.*(.text.call16big)
. = ( 0xf56dc - code32flat_start ) ;
*32flat.*(.text.yield)
. = ( 0xf5709 - code32flat_start ) ;
*32flat.*(.text.xhci_event_wait)
. = ( 0xf5761 - code32flat_start ) ;
*32flat.*(.text.ahci_command)
. = ( 0xf59d4 - code32flat_start ) ;
*32flat.*(.text.ahci_disk_readwrite_aligned)
. = ( 0xf5ad1 - code32flat_start ) ;
*32flat.*(.text.ahci_disk_readwrite)
. = ( 0xf5ba6 - code32flat_start ) ;
*32flat.*(.text.ehci_waittick.isra.44)
. = ( 0xf5c1f - code32flat_start ) ;
*32flat.*(.text.ehci_wait_td)
. = ( 0xf5cfd - code32flat_start ) ;
*32flat.*(.text.ehci_send_bulk)
. = ( 0xf5e19 - code32flat_start ) ;
*32flat.*(.text.usb_send_bulk)
. = ( 0xf5ea1 - code32flat_start ) ;
*32flat.*(.text.usb_cmd_data)
. = ( 0xf5fca - code32flat_start ) ;
*32flat.*(.text.timer_sleep)
. = ( 0xf5fe8 - code32flat_start ) ;
*32flat.*(.text.farcall16)
. = ( 0xf6015 - code32flat_start ) ;
*32flat.*(.text.call_boot_entry)
. = ( 0xf606f - code32flat_start ) ;
*32flat.*(.text.boot_disk)
. = ( 0xf6107 - code32flat_start ) ;
*32flat.*(.text.screenc)
. = ( 0xf614f - code32flat_start ) ;
*32flat.*(.text.screen_putc)
. = ( 0xf618a - code32flat_start ) ;
*32flat.*(.text.cdb_cmd_data)
. = ( 0xf64bd - code32flat_start ) ;
*32flat.*(.text.cdb_read)
. = ( 0xf64fa - code32flat_start ) ;
*32flat.*(.text.scsi_is_ready)
. = ( 0xf65f4 - code32flat_start ) ;
*32flat.*(.text.cdrom_boot)
. = ( 0xf6867 - code32flat_start ) ;
*32flat.*(.text.boot_fail)
. = ( 0xf695a - code32flat_start ) ;
*32flat.*(.text.do_boot)
. = ( 0xf6c40 - code32flat_start ) ;
*32flat.*(.text.runtime./home/jordanr/volume1/dolphin_12012016/SageBios_Mohon_Peak/coreboot/payloads/seabios/src/stacks.c.544)
. = ( 0xf6c50 - code32flat_start ) ;
*32flat.*(.text.runtime./home/jordanr/volume1/dolphin_12012016/SageBios_Mohon_Peak/coreboot/payloads/seabios/src/block.c.496)
. = ( 0xf6cc2 - code32flat_start ) ;
*32flat.*(.text.runtime./home/jordanr/volume1/dolphin_12012016/SageBios_Mohon_Peak/coreboot/payloads/seabios/src/block.c.515)
. = ( 0xf6cda - code32flat_start ) ;
*32flat.*(.text.runtime./home/jordanr/volume1/dolphin_12012016/SageBios_Mohon_Peak/coreboot/payloads/seabios/src/resume.c.147)
. = ( 0xf6e2a - code32flat_start ) ;
*32flat.*(.text.runtime./home/jordanr/volume1/dolphin_12012016/SageBios_Mohon_Peak/coreboot/payloads/seabios/src/hw/sd_if.c.360)
. = ( 0xf6e2d - code32flat_start ) ;
*32flat.*(.text.runtime./home/jordanr/volume1/dolphin_12012016/SageBios_Mohon_Peak/coreboot/payloads/seabios/src/post.c.216)
. = ( 0xf6e7e - code32flat_start ) ;
*32flat.*(.text.runtime./home/jordanr/volume1/dolphin_12012016/SageBios_Mohon_Peak/coreboot/payloads/seabios/src/post.c.357)
. = ( 0xf6edd - code32flat_start ) ;
*32flat.*(.text.runtime./home/jordanr/volume1/dolphin_12012016/SageBios_Mohon_Peak/coreboot/payloads/seabios/src/boot.c.849)
. = ( 0xf6f2e - code32flat_start ) ;
*32flat.*(.text.runtime./home/jordanr/volume1/dolphin_12012016/SageBios_Mohon_Peak/coreboot/payloads/seabios/src/boot.c.860)
. = ( 0xf6f65 - code32flat_start ) ;
*32flat.*(.text.runtime./home/jordanr/volume1/dolphin_12012016/SageBios_Mohon_Peak/coreboot/payloads/seabios/src/hw/ahci.c.299)
. = ( 0xf6fb8 - code32flat_start ) ;
*32flat.*(.text.runtime./home/jordanr/volume1/dolphin_12012016/SageBios_Mohon_Peak/coreboot/payloads/seabios/src/hw/usb-xhci.c.1163)
. = ( 0xf7021 - code32flat_start ) ;
_rodata32flat = . ;
*32flat.*(.rodata)
. = ( 0xf8718 - code32flat_start ) ;
*32flat.*(.rodata.puthex)
. = ( 0xf8734 - code32flat_start ) ;
*32flat.*(.rodata.__func__.6808)
. = ( 0xf8744 - code32flat_start ) ;
*32flat.*(.rodata.__func__.6679)
. = ( 0xf8754 - code32flat_start ) ;
*32flat.*(.rodata.__func__.11604)
. = ( 0xf8764 - code32flat_start ) ;
*32flat.*(.rodata.__func__.11401)
. = ( 0xf8778 - code32flat_start ) ;
*32flat.*(.rodata.__func__.11421)
. = ( 0xf8788 - code32flat_start ) ;
*32flat.*(.rodata.__func__.10838)
. = ( 0xf8798 - code32flat_start ) ;
*32flat.*(.rodata.__func__.10151)
. = ( 0xf87a4 - code32flat_start ) ;
*32flat.*(.rodata.__func__.10156)
. = ( 0xf87b0 - code32flat_start ) ;
*32flat.*(.data.debuginfo)
. = ( 0xf87b4 - code32flat_start ) ;
*32flat.*(.data.screeninfo)
. = ( 0xf87b8 - code32flat_start ) ;
*32flat.*(.data.VERSION)
. = ( 0xf87ec - code32flat_start ) ;
*32flat.*(.bss.acpi_reset_reg)
. = ( 0xf87f8 - code32flat_start ) ;
*32flat.*(.bss.acpi_reset_val)
. = ( 0xf87fc - code32flat_start ) ;
*32flat.*(.bss.BootRetryTime)
. = ( 0xf8800 - code32flat_start ) ;
*32flat.*(.bss.RsdpAddr)
. = ( 0xf8804 - code32flat_start ) ;
*32flat.*(.bss.ScreenAndDebug)
. = ( 0xf8808 - code32flat_start ) ;
*32flat.*(.bss.BEVCount)
. = ( 0xf880c - code32flat_start ) ;
*32flat.*(.bss.BEV)
. = ( 0xf8900 - code32flat_start ) ;
*32flat.*(.data.varfseg./home/jordanr/volume1/dolphin_12012016/SageBios_Mohon_Peak/coreboot/payloads/seabios/src/fw/biostables.c.184)
. = ( 0xf8904 - code32flat_start ) ;
*32flat.*(.data.varfseg./home/jordanr/volume1/dolphin_12012016/SageBios_Mohon_Peak/coreboot/payloads/seabios/src/fw/biostables.c.21)
. = ( 0xf8910 - code32flat_start ) ;
*32flat.*(.data.varfseg./home/jordanr/volume1/dolphin_12012016/SageBios_Mohon_Peak/coreboot/payloads/seabios/src/pmm.c.19)
. = ( 0xf8920 - code32flat_start ) ;
*32flat.*(.data.varfseg./home/jordanr/volume1/dolphin_12012016/SageBios_Mohon_Peak/coreboot/payloads/seabios/src/malloc.c.454)
. = ( 0xf8924 - code32flat_start ) ;
*32flat.*(.data.varfseg./home/jordanr/volume1/dolphin_12012016/SageBios_Mohon_Peak/coreboot/payloads/seabios/src/memmap.c.19)
. = ( 0xf8928 - code32flat_start ) ;
*32flat.*(.data.varfseg./home/jordanr/volume1/dolphin_12012016/SageBios_Mohon_Peak/coreboot/payloads/seabios/src/memmap.c.18)
. = ( 0xf8ba8 - code32flat_start ) ;
*32flat.*(.data.varfseg./home/jordanr/volume1/dolphin_12012016/SageBios_Mohon_Peak/coreboot/payloads/seabios/src/hw/floppy.c.42)
. = ( 0xf8bb8 - code32flat_start ) ;
*32flat.*(.data.varfseg./home/jordanr/volume1/dolphin_12012016/SageBios_Mohon_Peak/coreboot/payloads/seabios/src/hw/usb-hid.c.16)
. = ( 0xf8bbc - code32flat_start ) ;
*32flat.*(.data.varfseg./home/jordanr/volume1/dolphin_12012016/SageBios_Mohon_Peak/coreboot/payloads/seabios/src/hw/usb-hid.c.15)
. = ( 0xf8bc0 - code32flat_start ) ;
*32flat.*(.data.varfseg./home/jordanr/volume1/dolphin_12012016/SageBios_Mohon_Peak/coreboot/payloads/seabios/src/hw/timer.c.54)
. = ( 0xf8bc2 - code32flat_start ) ;
*32flat.*(.data.varfseg./home/jordanr/volume1/dolphin_12012016/SageBios_Mohon_Peak/coreboot/payloads/seabios/src/hw/timer.c.53)
. = ( 0xf8bc4 - code32flat_start ) ;
*32flat.*(.data.varfseg./home/jordanr/volume1/dolphin_12012016/SageBios_Mohon_Peak/coreboot/payloads/seabios/src/hw/timer.c.52)
. = ( 0xf8bc8 - code32flat_start ) ;
*32flat.*(.data.varfseg./home/jordanr/volume1/dolphin_12012016/SageBios_Mohon_Peak/coreboot/payloads/seabios/src/hw/pci.c.90)
. = ( 0xf8bd0 - code32flat_start ) ;
*32flat.*(.data.varfseg./home/jordanr/volume1/dolphin_12012016/SageBios_Mohon_Peak/coreboot/payloads/seabios/src/pcibios.c.228)
. = ( 0xf8be0 - code32flat_start ) ;
*32flat.*(.data.varfseg./home/jordanr/volume1/dolphin_12012016/SageBios_Mohon_Peak/coreboot/payloads/seabios/src/pnpbios.c.18)
. = ( 0xf8c04 - code32flat_start ) ;
*32flat.*(.data.varfseg./home/jordanr/volume1/dolphin_12012016/SageBios_Mohon_Peak/coreboot/payloads/seabios/src/cdrom.c.29)
. = ( 0xf8c08 - code32flat_start ) ;
*32flat.*(.data.varfseg./home/jordanr/volume1/dolphin_12012016/SageBios_Mohon_Peak/coreboot/payloads/seabios/src/block.c.31)
. = ( 0xf8c0c - code32flat_start ) ;
*32flat.*(.data.varfseg./home/jordanr/volume1/dolphin_12012016/SageBios_Mohon_Peak/coreboot/payloads/seabios/src/block.c.30)
. = ( 0xf8d0c - code32flat_start ) ;
*32flat.*(.data.varfseg./home/jordanr/volume1/dolphin_12012016/SageBios_Mohon_Peak/coreboot/payloads/seabios/src/block.c.27)
. = ( 0xf8d10 - code32flat_start ) ;
*32flat.*(.data.varfseg./home/jordanr/volume1/dolphin_12012016/SageBios_Mohon_Peak/coreboot/payloads/seabios/src/stacks.c.477)
. = ( 0xf8d14 - code32flat_start ) ;
*32flat.*(.data.varfseg./home/jordanr/volume1/dolphin_12012016/SageBios_Mohon_Peak/coreboot/payloads/seabios/src/stacks.c.262)
. = ( 0xf8d20 - code32flat_start ) ;
*32flat.*(.data.varfseg./home/jordanr/volume1/dolphin_12012016/SageBios_Mohon_Peak/coreboot/payloads/seabios/src/misc.c.210)
. = ( 0xf8d28 - code32flat_start ) ;
*32flat.*(.data.varfseg./home/jordanr/volume1/dolphin_12012016/SageBios_Mohon_Peak/coreboot/payloads/seabios/src/misc.c.192)
. = ( 0xf8d60 - code32flat_start ) ;
*32flat.*(.data.varfseg./home/jordanr/volume1/dolphin_12012016/SageBios_Mohon_Peak/coreboot/payloads/seabios/src/misc.c.186)
. = ( 0xf8d66 - code32flat_start ) ;
*32flat.*(.data.varfseg./home/jordanr/volume1/dolphin_12012016/SageBios_Mohon_Peak/coreboot/payloads/seabios/src/misc.c.183)
. = ( 0xf8d68 - code32flat_start ) ;
*32flat.*(.data.varfseg./home/jordanr/volume1/dolphin_12012016/SageBios_Mohon_Peak/coreboot/payloads/seabios/src/misc.c.176)
. = ( 0xf8d70 - code32flat_start ) ;
*32flat.*(.data.varfseg./home/jordanr/volume1/dolphin_12012016/SageBios_Mohon_Peak/coreboot/payloads/seabios/src/misc.c.20)
. = ( 0xf8d74 - code32flat_start ) ;
*32seg.*(.text.get_global_offset)
. = ( 0xf8d80 - code32flat_start ) ;
*32seg.*(.text.serial_debug)
. = ( 0xf8da1 - code32flat_start ) ;
*32seg.*(.text.serial_debug_putc)
. = ( 0xf8dbb - code32flat_start ) ;
*32seg.*(.text.putsinglehex.isra.5)
. = ( 0xf8dce - code32flat_start ) ;
*32seg.*(.text.puthex.isra.6)
. = ( 0xf8e53 - code32flat_start ) ;
*32seg.*(.text.putprettyhex.isra.7)
. = ( 0xf8e8a - code32flat_start ) ;
*32seg.*(.text.set_success)
. = ( 0xf8e90 - code32flat_start ) ;
*32seg.*(.text.set_code_success)
. = ( 0xf8e9a - code32flat_start ) ;
*32seg.*(.text.pci_next)
. = ( 0xf8f07 - code32flat_start ) ;
*32seg.*(.text.putuint.isra.9)
. = ( 0xf8f3b - code32flat_start ) ;
*32seg.*(.text.__dprintf)
. = ( 0xf913d - code32flat_start ) ;
*32seg.*(.text.dump_regs)
. = ( 0xf91de - code32flat_start ) ;
*32seg.*(.text.__set_code_invalid)
. = ( 0xf9219 - code32flat_start ) ;
*32seg.*(.text.handle_pcibios)
. = ( 0xf95bc - code32flat_start ) ;
*32seg.*(.text.handle_apm)
. = ( 0xf9771 - code32flat_start ) ;
_rodata32seg = . ;
*32seg.*(.rodata)
. = ( 0xf9840 - code32flat_start ) ;
*32seg.*(.rodata.__func__.2780)
. = ( 0xf9850 - code32flat_start ) ;
*32seg.*(.rodata.__func__.2800)
. = ( 0xf9860 - code32flat_start ) ;
*32seg.*(.rodata.__func__.2827)
. = ( 0xf9870 - code32flat_start ) ;
*32seg.*(.rodata.__func__.2868)
. = ( 0xf9880 - code32flat_start ) ;
*32seg.*(.rodata.__func__.2964)
. = ( 0xf9890 - code32flat_start ) ;
*16.*(.text.invoke_mouse_handler)
. = ( 0xf98d7 - code32flat_start ) ;
*16.*(.text.enqueue_key)
. = ( 0xf993b - code32flat_start ) ;
*16.*(.text.set_a20)
. = ( 0xf995b - code32flat_start ) ;
*16.*(.text.ps2_kbd_command)
. = ( 0xf9961 - code32flat_start ) ;
*16.*(.text.serial_debug)
. = ( 0xf9989 - code32flat_start ) ;
*16.*(.text.serial_debug_putc)
. = ( 0xf99a6 - code32flat_start ) ;
*16.*(.text.serial_debug_flush)
. = ( 0xf99c3 - code32flat_start ) ;
*16.*(.text.ehci_reset_pipe)
. = ( 0xf9a06 - code32flat_start ) ;
*16.*(.text.usb_kbd_command)
. = ( 0xf9a21 - code32flat_start ) ;
*16.*(.text.usb_mouse_command)
. = ( 0xf9a93 - code32flat_start ) ;
*16.*(.text.stack_hop)
. = ( 0xf9af8 - code32flat_start ) ;
*16.*(.text.send_disk_op)
. = ( 0xf9b07 - code32flat_start ) ;
*16.*(.text._farcall16)
. = ( 0xf9b48 - code32flat_start ) ;
*16.*(.text.farcall16)
. = ( 0xf9b51 - code32flat_start ) ;
*16.*(.text.check_irqs)
. = ( 0xf9b73 - code32flat_start ) ;
*16.*(.text.wait_irq)
. = ( 0xf9b93 - code32flat_start ) ;
*16.*(.text.dequeue_key)
. = ( 0xf9c61 - code32flat_start ) ;
*16.*(.text.getLCHS)
. = ( 0xf9cdf - code32flat_start ) ;
*16.*(.text.putprettyhex.isra.24)
. = ( 0xf9d2a - code32flat_start ) ;
*16.*(.text.kbd_command)
. = ( 0xf9d46 - code32flat_start ) ;
*16.*(.text.set_leds)
. = ( 0xf9da5 - code32flat_start ) ;
*16.*(.text.mouse_command)
. = ( 0xf9dc1 - code32flat_start ) ;
*16.*(.text.call32.part.73)
. = ( 0xf9e7a - code32flat_start ) ;
*16.*(.text.clear_usertimer)
. = ( 0xf9ebd - code32flat_start ) ;
*16.*(.text.memset.constprop.85)
. = ( 0xf9ecd - code32flat_start ) ;
*16.*(.text.set_code_success)
. = ( 0xf9ed9 - code32flat_start ) ;
*16.*(.text.pci_next)
. = ( 0xf9f64 - code32flat_start ) ;
*16.*(.text.timer_read)
. = ( 0xfa00e - code32flat_start ) ;
*16.*(.text.rtc_updating)
. = ( 0xfa065 - code32flat_start ) ;
*16.*(.text.putuint.isra.26)
. = ( 0xfa0ac - code32flat_start ) ;
*16.*(.text.__dprintf)
. = ( 0xfa0c6 - code32flat_start ) ;
*16.*(.text.__warn_invalid)
. = ( 0xfa0f8 - code32flat_start ) ;
*16.*(.text.__set_code_invalid)
. = ( 0xfa11e - code32flat_start ) ;
*16.*(.text.mouse_15c201)
. = ( 0xfa174 - code32flat_start ) ;
*16.*(.text.disk_1300)
. = ( 0xfa1af - code32flat_start ) ;
*16.*(.text.disk_1308)
. = ( 0xfa2e3 - code32flat_start ) ;
*16.*(.text.disk_1310)
. = ( 0xfa322 - code32flat_start ) ;
*16.*(.text.disk_1315)
. = ( 0xfa38a - code32flat_start ) ;
*16.*(.text.disk_1346.isra.61)
. = ( 0xfa440 - code32flat_start ) ;
*16.*(.text.basic_access)
. = ( 0xfa59b - code32flat_start ) ;
*16.*(.text.extended_access)
. = ( 0xfa689 - code32flat_start ) ;
*16.*(.text.getComAddr)
. = ( 0xfa6d9 - code32flat_start ) ;
*16.*(.text.__debug_enter)
. = ( 0xfa705 - code32flat_start ) ;
*16.*(.text.process_key)
. = ( 0xfaa64 - code32flat_start ) ;
*16.*(.text.prockeys)
. = ( 0xfaaae - code32flat_start ) ;
*16.*(.text.procscankey.part.72)
. = ( 0xfaacb - code32flat_start ) ;
*16.*(.text.ehci_send_bulk)
. = ( 0xfacfb - code32flat_start ) ;
*16.*(.text.usb_send_bulk)
. = ( 0xfad2b - code32flat_start ) ;
*16.*(.text.usb_cmd_data)
. = ( 0xfaeff - code32flat_start ) ;
*16.*(.text.disk_1305)
. = ( 0xfb026 - code32flat_start ) ;
*16.*(.text.__set_code_unimplemented)
. = ( 0xfb077 - code32flat_start ) ;
*16.*(.text.__disk_ret_unimplemented)
. = ( 0xfb09f - code32flat_start ) ;
*16.*(.text.__disk_stub)
. = ( 0xfb0f2 - code32flat_start ) ;
*16.*(.text.__set_unimplemented)
. = ( 0xfb12c - code32flat_start ) ;
*16.*(.text.panic)
. = ( 0xfb148 - code32flat_start ) ;
*16.*(.text.cdb_cmd_data)
. = ( 0xfb229 - code32flat_start ) ;
*16.*(.text.cdb_write)
. = ( 0xfb284 - code32flat_start ) ;
*16.*(.text.cdb_read)
. = ( 0xfb2df - code32flat_start ) ;
*16.*(.text.process_scsi_op)
. = ( 0xfb31d - code32flat_start ) ;
*16.*(.text.fill_generic_edd.constprop.80)
. = ( 0xfb633 - code32flat_start ) ;
*16.*(.text.disk_13)
. = ( 0xfba1c - code32flat_start ) ;
*16.*(.text.handle_legacy_disk)
. = ( 0xfbaca - code32flat_start ) ;
*16.*(.text.handle_12)
. = ( 0xfbaef - code32flat_start ) ;
*16.*(.text.handle_11)
. = ( 0xfbb14 - code32flat_start ) ;
*16.*(.text.handle_02)
. = ( 0xfbb2f - code32flat_start ) ;
*16.*(.text.handle_75)
. = ( 0xfbb97 - code32flat_start ) ;
*16.*(.text.process_op)
. = ( 0xfbd27 - code32flat_start ) ;
*16.*(.text.__send_disk_op)
. = ( 0xfbd77 - code32flat_start ) ;
*16.*(.text.call32_params.constprop.84)
. = ( 0xfbdbf - code32flat_start ) ;
*16.*(.text.handle_40)
. = ( 0xfbdde - code32flat_start ) ;
*16.*(.text.handle_13)
. = ( 0xfbe98 - code32flat_start ) ;
*16.*(.text.handle_16)
. = ( 0xfbff2 - code32flat_start ) ;
*16.*(.text.handle_1589)
. = ( 0xfc093 - code32flat_start ) ;
*16.*(.text.handle_15)
. = ( 0xfc7fd - code32flat_start ) ;
*16.*(.text.handle_17)
. = ( 0xfc822 - code32flat_start ) ;
*16.*(.text.handle_70)
. = ( 0xfc91f - code32flat_start ) ;
*16.*(.text.handle_resume)
. = ( 0xfc9f6 - code32flat_start ) ;
*16.*(.text.handle_pnp)
. = ( 0xfca4b - code32flat_start ) ;
*16.*(.text.handle_pcibios)
. = ( 0xfcdeb - code32flat_start ) ;
*16.*(.text.handle_hwpic1)
. = ( 0xfcdf1 - code32flat_start ) ;
*16.*(.text.handle_hwpic2)
. = ( 0xfcdf9 - code32flat_start ) ;
*16.*(.text.asm.transition32)
. = ( 0xfce44 - code32flat_start ) ;
*16.*(.text.asm.transition16)
. = ( 0xfce9f - code32flat_start ) ;
*16.*(.text.asm.__call16)
. = ( 0xfceee - code32flat_start ) ;
*16.*(.text.asm.irq_trampoline_0x02)
. = ( 0xfcef1 - code32flat_start ) ;
*16.*(.text.asm.irq_trampoline_0x10)
. = ( 0xfcef4 - code32flat_start ) ;
*16.*(.text.asm.irq_trampoline_0x13)
. = ( 0xfcef7 - code32flat_start ) ;
*16.*(.text.asm.irq_trampoline_0x15)
. = ( 0xfcefa - code32flat_start ) ;
*16.*(.text.asm.irq_trampoline_0x16)
. = ( 0xfcefd - code32flat_start ) ;
*16.*(.text.asm.irq_trampoline_0x18)
. = ( 0xfcf00 - code32flat_start ) ;
*16.*(.text.asm.entry_resume)
. = ( 0xfcf15 - code32flat_start ) ;
*16.*(.text.asm.entry_pmm)
. = ( 0xfcf5e - code32flat_start ) ;
*16.*(.text.asm.entry_pnp_real)
. = ( 0xfcf96 - code32flat_start ) ;
*16.*(.text.asm.entry_apm16)
. = ( 0xfcfd7 - code32flat_start ) ;
*16.*(.text.asm.entry_apm32)
. = ( 0xfd009 - code32flat_start ) ;
*16.*(.text.asm.entry_pcibios32)
. = ( 0xfd037 - code32flat_start ) ;
*16.*(.text.asm.entry_pcibios16)
. = ( 0xfd071 - code32flat_start ) ;
*16.*(.text.asm.entry_1589)
. = ( 0xfd0ab - code32flat_start ) ;
*16.*(.text.asm.entry_bios32)
. = ( 0xfd0ca - code32flat_start ) ;
*16.*(.text.asm.entry_elf)
. = ( 0xfd0f5 - code32flat_start ) ;
*16.*(.text.asm.irqentry_extrastack)
. = ( 0xfd15b - code32flat_start ) ;
*16.*(.text.asm.irqentry_arg_extrastack)
. = ( 0xfd1fe - code32flat_start ) ;
*16.*(.text.asm.entry_13)
. = ( 0xfd207 - code32flat_start ) ;
*16.*(.text.asm.entry_70)
. = ( 0xfd210 - code32flat_start ) ;
*16.*(.text.asm.entry_75)
. = ( 0xfd219 - code32flat_start ) ;
*16.*(.text.asm.entry_hwpic1)
. = ( 0xfd222 - code32flat_start ) ;
*16.*(.text.asm.entry_hwpic2)
. = ( 0xfd22b - code32flat_start ) ;
*16.*(.text.asm.entry_19)
. = ( 0xfd23e - code32flat_start ) ;
*16.*(.text.asm.entry_18)
. = ( 0xfd251 - code32flat_start ) ;
_rodata16 = . ;
*16.*(.rodata)
. = ( 0xfd774 - code32flat_start ) ;
*16.*(.rodata.__func__.1756)
. = ( 0xfd780 - code32flat_start ) ;
*16.*(.rodata.__func__.1765)
. = ( 0xfd78c - code32flat_start ) ;
*16.*(.rodata.__func__.1774)
. = ( 0xfd798 - code32flat_start ) ;
*16.*(.rodata.__func__.1782)
. = ( 0xfd7a4 - code32flat_start ) ;
*16.*(.rodata.__func__.1795)
. = ( 0xfd7b0 - code32flat_start ) ;
*16.*(.rodata.__func__.4566)
. = ( 0xfd7bc - code32flat_start ) ;
*16.*(.rodata.__func__.4496)
. = ( 0xfd7c8 - code32flat_start ) ;
*16.*(.rodata.__func__.4219)
. = ( 0xfd7d4 - code32flat_start ) ;
*16.*(.rodata.__func__.8292)
. = ( 0xfd7e4 - code32flat_start ) ;
*16.*(.rodata.__func__.4175)
. = ( 0xfd7f4 - code32flat_start ) ;
*16.*(.rodata.__func__.4251)
. = ( 0xfd800 - code32flat_start ) ;
*16.*(.rodata.__func__.4292)
. = ( 0xfd80c - code32flat_start ) ;
*16.*(.rodata.__func__.4308)
. = ( 0xfd818 - code32flat_start ) ;
*16.*(.rodata.__func__.4313)
. = ( 0xfd824 - code32flat_start ) ;
*16.*(.rodata.__func__.4318)
. = ( 0xfd830 - code32flat_start ) ;
*16.*(.rodata.__func__.4325)
. = ( 0xfd83c - code32flat_start ) ;
*16.*(.rodata.__func__.4330)
. = ( 0xfd848 - code32flat_start ) ;
*16.*(.rodata.__func__.4335)
. = ( 0xfd854 - code32flat_start ) ;
*16.*(.rodata.__func__.4340)
. = ( 0xfd860 - code32flat_start ) ;
*16.*(.rodata.__func__.4350)
. = ( 0xfd86c - code32flat_start ) ;
*16.*(.rodata.__func__.4355)
. = ( 0xfd878 - code32flat_start ) ;
*16.*(.rodata.__func__.4197)
. = ( 0xfd888 - code32flat_start ) ;
*16.*(.rodata.__func__.4421)
. = ( 0xfd894 - code32flat_start ) ;
*16.*(.rodata.__func__.4379)
. = ( 0xfd8a0 - code32flat_start ) ;
*16.*(.rodata.__func__.4395)
. = ( 0xfd8ac - code32flat_start ) ;
*16.*(.rodata.__func__.4411)
. = ( 0xfd8b8 - code32flat_start ) ;
*16.*(.rodata.__func__.4416)
. = ( 0xfd8c4 - code32flat_start ) ;
*16.*(.rodata.__func__.4431)
. = ( 0xfd8d0 - code32flat_start ) ;
*16.*(.rodata.__func__.4451)
. = ( 0xfd8dc - code32flat_start ) ;
*16.*(.rodata.__func__.4456)
. = ( 0xfd8e8 - code32flat_start ) ;
*16.*(.rodata.__func__.4461)
. = ( 0xfd8f4 - code32flat_start ) ;
*16.*(.rodata.__func__.4466)
. = ( 0xfd900 - code32flat_start ) ;
*16.*(.rodata.__func__.4471)
. = ( 0xfd90c - code32flat_start ) ;
*16.*(.rodata.__func__.4476)
. = ( 0xfd918 - code32flat_start ) ;
*16.*(.rodata.__func__.4481)
. = ( 0xfd924 - code32flat_start ) ;
*16.*(.rodata.__func__.4559)
. = ( 0xfd938 - code32flat_start ) ;
*16.*(.rodata.__func__.4554)
. = ( 0xfd944 - code32flat_start ) ;
*16.*(.rodata.__func__.4998)
. = ( 0xfd950 - code32flat_start ) ;
*16.*(.rodata.__func__.5209)
. = ( 0xfd960 - code32flat_start ) ;
*16.*(.rodata.__func__.5853)
. = ( 0xfd96c - code32flat_start ) ;
*16.*(.rodata.__func__.6224)
. = ( 0xfd97c - code32flat_start ) ;
*16.*(.rodata.__func__.5845)
. = ( 0xfd98c - code32flat_start ) ;
*16.*(.rodata.__func__.5849)
. = ( 0xfd99c - code32flat_start ) ;
*16.*(.rodata.__func__.5710)
. = ( 0xfd9ac - code32flat_start ) ;
*16.*(.rodata.__func__.5717)
. = ( 0xfd9bc - code32flat_start ) ;
*16.*(.rodata.__func__.5702)
. = ( 0xfd9c8 - code32flat_start ) ;
*16.*(.rodata.__func__.4631)
. = ( 0xfd9d8 - code32flat_start ) ;
*16.*(.rodata.__func__.4642)
. = ( 0xfd9e8 - code32flat_start ) ;
*16.*(.rodata.__func__.4647)
. = ( 0xfd9f8 - code32flat_start ) ;
*16.*(.rodata.__func__.4660)
. = ( 0xfda08 - code32flat_start ) ;
*16.*(.rodata.__func__.4665)
. = ( 0xfda18 - code32flat_start ) ;
*16.*(.rodata.__func__.4675)
. = ( 0xfda28 - code32flat_start ) ;
*16.*(.rodata.__func__.4683)
. = ( 0xfda38 - code32flat_start ) ;
*16.*(.rodata.__func__.4687)
. = ( 0xfda48 - code32flat_start ) ;
*16.*(.rodata.__func__.4702)
. = ( 0xfda58 - code32flat_start ) ;
*16.*(.rodata.__func__.4707)
. = ( 0xfda68 - code32flat_start ) ;
*16.*(.rodata.__func__.4712)
. = ( 0xfda78 - code32flat_start ) ;
*16.*(.rodata.__func__.4716)
. = ( 0xfda88 - code32flat_start ) ;
*16.*(.rodata.__func__.4749)
. = ( 0xfda98 - code32flat_start ) ;
*16.*(.rodata.__func__.5293)
. = ( 0xfdaa8 - code32flat_start ) ;
*16.*(.rodata.__func__.5297)
. = ( 0xfdab8 - code32flat_start ) ;
*16.*(.rodata.__func__.5308)
. = ( 0xfdac4 - code32flat_start ) ;
*16.*(.rodata.__func__.5403)
. = ( 0xfdad0 - code32flat_start ) ;
*16.*(.rodata.__func__.5354)
. = ( 0xfdadc - code32flat_start ) ;
*16.*(.rodata.__func__.5399)
. = ( 0xfdae8 - code32flat_start ) ;
*16.*(.rodata.__func__.5467)
. = ( 0xfdaf4 - code32flat_start ) ;
*16.*(.rodata.__func__.5463)
. = ( 0xfdb00 - code32flat_start ) ;
*16.*(.rodata.__func__.5560)
. = ( 0xfdb0c - code32flat_start ) ;
*16.*(.rodata.__func__.5568)
. = ( 0xfdb18 - code32flat_start ) ;
*16.*(.rodata.__func__.5577)
. = ( 0xfdb24 - code32flat_start ) ;
*16.*(.rodata.__func__.5587)
. = ( 0xfdb30 - code32flat_start ) ;
*16.*(.rodata.__func__.5595)
. = ( 0xfdb3c - code32flat_start ) ;
*16.*(.rodata.__func__.6040)
. = ( 0xfdb4c - code32flat_start ) ;
*16.*(.rodata.__func__.6060)
. = ( 0xfdb5c - code32flat_start ) ;
*16.*(.rodata.__func__.6087)
. = ( 0xfdb6c - code32flat_start ) ;
*16.*(.rodata.__func__.6128)
. = ( 0xfdb7c - code32flat_start ) ;
*16.*(.data16./home/jordanr/volume1/dolphin_12012016/SageBios_Mohon_Peak/coreboot/payloads/seabios/src/mouse.c.106)
. = ( 0xfdb84 - code32flat_start ) ;
*16.*(.data16./home/jordanr/volume1/dolphin_12012016/SageBios_Mohon_Peak/coreboot/payloads/seabios/src/hw/usb-hid.c.142)
. = ( 0xfdc4c - code32flat_start ) ;
*16.*(.data16./home/jordanr/volume1/dolphin_12012016/SageBios_Mohon_Peak/coreboot/payloads/seabios/src/kbd.c.292)
. = ( 0xfdfc8 - code32flat_start ) ;
*16.*(.data16./home/jordanr/volume1/dolphin_12012016/SageBios_Mohon_Peak/coreboot/payloads/seabios/src/hw/usb-hid.c.159)
. = ( 0xfdfd8 - code32flat_start ) ;
*16.*(.data16./home/jordanr/volume1/dolphin_12012016/SageBios_Mohon_Peak/coreboot/payloads/seabios/src/serial.c.331)
. = ( 0xfe05b - code32flat_start ) ;
*16.*(.fixedaddr.0xe05b)
. = ( 0xfe079 - code32flat_start ) ;
*16.*(.text.bvprintf.isra.27)
. = ( 0xfe2aa - code32flat_start ) ;
*16.*(.text.putsinglehex.isra.22)
. = ( 0xfe2c1 - code32flat_start ) ;
*16.*(.text.handle_09)
. = ( 0xfe2c3 - code32flat_start ) ;
*16.*(.fixedaddr.0xe2c3)
. = ( 0xfe2cc - code32flat_start ) ;
*16.*(.text.usb_poll_intr)
. = ( 0xfe3f5 - code32flat_start ) ;
*16.*(.text.handle_05)
. = ( 0xfe3fe - code32flat_start ) ;
*16.*(.fixedaddr.0xe3fe)
. = ( 0xfe401 - code32flat_start ) ;
*32flat.*(.fixedaddr.0xe401)
. = ( 0xfe411 - code32flat_start ) ;
*16.*(.text.cdemu_read)
. = ( 0xfe671 - code32flat_start ) ;
*16.*(.text.set_usertimer)
. = ( 0xfe6f2 - code32flat_start ) ;
*16.*(.fixedaddr.0xe6f2)
. = ( 0xfe6f5 - code32flat_start ) ;
*32flat.*(.fixedaddr.0xe6f5)
. = ( 0xfe6ff - code32flat_start ) ;
*16.*(.text.timer_sleep)
. = ( 0xfe727 - code32flat_start ) ;
*16.*(.text.handle_10)
. = ( 0xfe729 - code32flat_start ) ;
*32flat.*(.fixedaddr.0xe729)
. = ( 0xfe739 - code32flat_start ) ;
*16.*(.fixedaddr.0xe739)
. = ( 0xfe742 - code32flat_start ) ;
*16.*(.text.dump_regs)
. = ( 0xfe827 - code32flat_start ) ;
*16.*(.text.set_success)
. = ( 0xfe82e - code32flat_start ) ;
*16.*(.fixedaddr.0xe82e)
. = ( 0xfe837 - code32flat_start ) ;
*16.*(.text.ehci_wait_td)
. = ( 0xfe973 - code32flat_start ) ;
*16.*(.text.__set_invalid)
. = ( 0xfe987 - code32flat_start ) ;
*16.*(.fixedaddr.0xe987)
. = ( 0xfe990 - code32flat_start ) ;
*16.*(.text.handle_1a)
. = ( 0xfec35 - code32flat_start ) ;
*16.*(.text.on_extra_stack)
. = ( 0xfec59 - code32flat_start ) ;
*16.*(.fixedaddr.0xec59)
. = ( 0xfec62 - code32flat_start ) ;
*16.*(.text.handle_14)
. = ( 0xfeeae - code32flat_start ) ;
*16.*(.text.puthex.isra.23)
. = ( 0xfef57 - code32flat_start ) ;
*16.*(.fixedaddr.0xef57)
. = ( 0xfef60 - code32flat_start ) ;
*16.*(.text.process_mouse)
. = ( 0xfefc7 - code32flat_start ) ;
*32flat.*(.fixedaddr.0xefc7)
. = ( 0xfefd2 - code32flat_start ) ;
*16.*(.fixedaddr.0xefd2)
. = ( 0xfefdb - code32flat_start ) ;
*16.*(.text.stack_hop_back)
. = ( 0xff045 - code32flat_start ) ;
*16.*(.fixedaddr.0xf045)
. = ( 0xff046 - code32flat_start ) ;
*16.*(.text.puts_cs.isra.21)
. = ( 0xff065 - code32flat_start ) ;
*16.*(.fixedaddr.0xf065)
. = ( 0xff06e - code32flat_start ) ;
*16.*(.text.__disk_ret)
. = ( 0xff0a4 - code32flat_start ) ;
*32flat.*(.fixedaddr.0xf0a4)
. = ( 0xff0fc - code32flat_start ) ;
*16.*(.text.handle_08)
. = ( 0xff7b8 - code32flat_start ) ;
*16.*(.text.fill_edd)
. = ( 0xff83d - code32flat_start ) ;
*16.*(.text.asm.irq_trampoline_0x19)
. = ( 0xff841 - code32flat_start ) ;
*16.*(.fixedaddr.0xf841)
. = ( 0xff84a - code32flat_start ) ;
*16.*(.text.handle_apm)
. = ( 0xff84d - code32flat_start ) ;
*16.*(.fixedaddr.0xf84d)
. = ( 0xff856 - code32flat_start ) ;
*16.*(.text.asm.irq_trampoline_0x4a)
. = ( 0xff859 - code32flat_start ) ;
*16.*(.fixedaddr.0xf859)
. = ( 0xff869 - code32flat_start ) ;
*16.*(.text.virtio_scsi_cmd)
. = ( 0xffcba - code32flat_start ) ;
*16.*(.text.handle_1553)
. = ( 0xffe55 - code32flat_start ) ;
*16.*(.text.call32)
. = ( 0xffe6b - code32flat_start ) ;
*16.*(.text.asm.irq_trampoline_0x1c)
. = ( 0xffe6e - code32flat_start ) ;
*16.*(.fixedaddr.0xfe6e)
. = ( 0xffe7e - code32flat_start ) ;
*16.*(.text.rtc_setup)
. = ( 0xffea5 - code32flat_start ) ;
*16.*(.fixedaddr.0xfea5)
. = ( 0xffeae - code32flat_start ) ;
*16.*(.text.handle_160a.isra.35)
. = ( 0xffef1 - code32flat_start ) ;
*16.*(.text.handle_0e)
. = ( 0xffef3 - code32flat_start ) ;
*32flat.*(.fixedaddr.0xfef3)
. = ( 0xfff00 - code32flat_start ) ;
*16.*(.text.procmodkey)
. = ( 0xfff53 - code32flat_start ) ;
*16.*(.fixedaddr.0xff53)
. = ( 0xfff54 - code32flat_start ) ;
*16.*(.fixedaddr.0xff54)
. = ( 0xfff5d - code32flat_start ) ;
*16.*(.text.asm.__farcall16)
. = ( 0xfffea - code32flat_start ) ;
*16.*(.text.ps2_mouse_command)
. = ( 0xffff0 - code32flat_start ) ;
*16.*(.fixedaddr.0xfff0)
. = ( 0xffff5 - code32flat_start ) ;
*32flat.*(.fixedaddr.0xfff5)
. = ( 0xffffe - code32flat_start ) ;
*32flat.*(.fixedaddr.0xfffe)
. = ( 0xfffff - code32flat_start ) ;
*32flat.*(.fixedaddr.0xffff)

        code32flat_end = ABSOLUTE(.) ;
    } :text


        /* Discard regular data sections to force a link error if
         * code attempts to access data not marked with VAR16 (or other
         * appropriate macro)
         */
        /DISCARD/ : {
                *(.text*) *(.data*) *(.bss*) *(.rodata*)
                *(COMMON) *(.discard*) *(.eh_frame) *(.note*)
                }
}

ENTRY(entry_elf)
PHDRS
{
        text PT_LOAD AT ( code32flat_start ) ;
}
