## firmware/edge510-coreboot/SageBios_Mohon_Peak/coreboot/src/cpu/intel/fsp_haswell/Kconfig
```kconfig
##
## This file is part of the coreboot project.
##
## Copyright (C) 2014 Sage Electronic Engineering, LLC.
##
## This program is free software; you can redistribute it and/or modify
## it under the terms of the GNU General Public License as published by
## the Free Software Foundation; version 2 of the License.
##
## This program is distributed in the hope that it will be useful,
## but WITHOUT ANY WARRANTY; without even the implied warranty of
## MERCHANTABILITY or FITNESS FOR A PARTICULAR PURPOSE.  See the
## GNU General Public License for more details.
##
## You should have received a copy of the GNU General Public License
## along with this program; if not, write to the Free Software
## Foundation, Inc., 51 Franklin St, Fifth Floor, Boston, MA 02110-1301 USA
##

config CPU_INTEL_FSP_HASWELL
	bool

if CPU_INTEL_FSP_HASWELL

config CPU_SPECIFIC_OPTIONS
	def_bool y
	select ARCH_BOOTBLOCK_X86_32
	select ARCH_ROMSTAGE_X86_32
	select ARCH_RAMSTAGE_X86_32
	select PLATFORM_USES_FSP
	select BACKUP_DEFAULT_SMM_REGION
	select SMP
	select SSE2
	select UDELAY_TSC
	select TSC_CONSTANT_RATE
	select SMM_TSEG if HAVE_SMI_HANDLER
	select SMM_MODULES if HAVE_SMI_HANDLER
	select RELOCATABLE_MODULES
	select DYNAMIC_CBMEM
	select SUPPORT_CPU_UCODE_IN_CBFS if HAVE_FSP_BIN
	select TSC_SYNC_MFENCE
	select PARALLEL_MP
	select SAVE_EARLY_TIMESTAMPS_TO_CMOS if COLLECT_TIMESTAMPS

config BOOTBLOCK_CPU_INIT
	string
	default "cpu/intel/fsp_haswell/bootblock.c"

config SERIAL_CPU_INIT
	bool
	default n

config SMM_TSEG_SIZE
	hex
	default 0x800000
	#TODO - check this against the FSP

config IED_REGION_SIZE
	hex
	default 0x400000
	#TODO - Check this against the FSP

config SMM_RESERVED_SIZE
	hex
	default 0x100000
	#TODO - Check this against the FSP

config CPU_MICROCODE_CBFS_LOC
	hex
	depends on SUPPORT_CPU_UCODE_IN_CBFS
	default 0xfff10000

config MICROCODE_INCLUDE_PATH
	string "Location of the intel microcode patches"
	default "../intel/cpu/haswell/microcode"

endif
```

## firmware/edge510-coreboot/SageBios_Mohon_Peak/coreboot/src/mainboard/intel/mohonpeak/Kconfig
```kconfig
##
## This file is part of the coreboot project.
##
## Copyright (C) 2013 Sage Electronic Engineering, LLC.
##
## This program is free software; you can redistribute it and/or modify
## it under the terms of the GNU General Public License as published by
## the Free Software Foundation; version 2 of the License.
##
## This program is distributed in the hope that it will be useful,
## but WITHOUT ANY WARRANTY; without even the implied warranty of
## MERCHANTABILITY or FITNESS FOR A PARTICULAR PURPOSE.  See the
## GNU General Public License for more details.
##
## You should have received a copy of the GNU General Public License
## along with this program; if not, write to the Free Software
## Foundation, Inc., 51 Franklin St, Fifth Floor, Boston, MA 02110-1301 USA
##

if BOARD_INTEL_MOHONPEAK

config BOARD_SPECIFIC_OPTIONS # dummy
	def_bool y
	select ARCH_X86
	select CPU_INTEL_SOCKET_RPGA989
	select NORTHBRIDGE_INTEL_FSP_RANGELEY
	select SOUTHBRIDGE_INTEL_FSP_RANGELEY
	select BOARD_ROMSIZE_KB_8192
	select HAVE_ACPI_TABLES
	select HAVE_OPTION_TABLE
	select MMCONF_SUPPORT
	select HAVE_FSP_BIN
	select HAVE_MP_TABLE
	select HAVE_PIRQ_TABLE
	select EARLY_CBMEM_INIT

config MAINBOARD_DIR
	string
	default intel/mohonpeak

config MAINBOARD_PART_NUMBER
	string
	default "Mohon Peak"

config MMCONF_BASE_ADDRESS
	hex
	default 0xe0000000

config IRQ_SLOT_COUNT
	int
	default 18

config MAX_CPUS
	int
	default 16

config FSP_FILE
	string
	default "../intel/fsp/rangeley/FvFsp.bin"

config GPIO_TPM
	bool "ADI RCC-VE with TPM"
	default n
	help
	  Enable for boards with TPM.

endif # BOARD_INTEL_MOHONPEAK
```

## firmware/edge510-coreboot/SageBios_Mohon_Peak/coreboot/src/northbridge/intel/fsp_rangeley/Kconfig
```kconfig
##
## This file is part of the coreboot project.
##
## Copyright (C) 2010 Google Inc.
## Copyright (C) 2013 Sage Electronic Engineering, LLC.
##
## This program is free software; you can redistribute it and/or modify
## it under the terms of the GNU General Public License as published by
## the Free Software Foundation; version 2 of the License.
##
## This program is distributed in the hope that it will be useful,
## but WITHOUT ANY WARRANTY; without even the implied warranty of
## MERCHANTABILITY or FITNESS FOR A PARTICULAR PURPOSE.  See the
## GNU General Public License for more details.
##
## You should have received a copy of the GNU General Public License
## along with this program; if not, write to the Free Software
## Foundation, Inc., 51 Franklin St, Fifth Floor, Boston, MA  02110-1301 USA
##

config NORTHBRIDGE_INTEL_FSP_RANGELEY
	bool
	select CPU_INTEL_FSP_MODEL_406DX

if NORTHBRIDGE_INTEL_FSP_RANGELEY

config DCACHE_RAM_BASE
	hex
	default 0xfef00000

config DCACHE_RAM_SIZE
	hex
	default 0x4000

config CBFS_SIZE
	hex
	default 0x400000
	help
	  On Rangeley systems the firmware image may have to store a lot more
	  than just coreboot, including:
	   - a firmware descriptor
	   - Intel Management Engine firmware
	  This option specifies the maximum size of the CBFS portion in the
	  firmware image.

# Rangeley Specific FSP Kconfig
source src/northbridge/intel/fsp_rangeley/fsp/Kconfig

endif # NORTHBRIDGE_INTEL_FSP_RANGELEY
```

## firmware/edge510-coreboot/SageBios_Mohon_Peak/coreboot/src/southbridge/intel/fsp_rangeley/Kconfig
```kconfig
##
## This file is part of the coreboot project.
##
## Copyright (C) 2011 Google Inc.
## Copyright (C) 2013-2014 Sage Electronic Engineering, LLC.
##
## This program is free software; you can redistribute it and/or modify
## it under the terms of the GNU General Public License as published by
## the Free Software Foundation; version 2 of the License.
##
## This program is distributed in the hope that it will be useful,
## but WITHOUT ANY WARRANTY; without even the implied warranty of
## MERCHANTABILITY or FITNESS FOR A PARTICULAR PURPOSE.  See the
## GNU General Public License for more details.
##
## You should have received a copy of the GNU General Public License
## along with this program; if not, write to the Free Software
## Foundation, Inc., 51 Franklin St, Fifth Floor, Boston, MA  02110-1301 USA
##

config SOUTHBRIDGE_INTEL_FSP_RANGELEY
	bool

if SOUTHBRIDGE_INTEL_FSP_RANGELEY

config SOUTH_BRIDGE_OPTIONS # dummy
	def_bool y
	select IOAPIC
	select HAVE_HARD_RESET
	select HAVE_USBDEBUG
	select HAVE_USBDEBUG_OPTIONS
	select SOUTHBRIDGE_INTEL_COMMON
#	select HAVE_SMI_HANDLER
	select USE_WATCHDOG_ON_BOOT
	select PCIEXP_ASPM
	select PCIEXP_COMMON_CLOCK
	select SPI_FLASH

config EHCI_BAR
	hex
	default 0xfe700000

config EHCI_DEBUG_OFFSET
	hex
	default 0xa0

config BOOTBLOCK_SOUTHBRIDGE_INIT
	string
	default "southbridge/intel/fsp_rangeley/bootblock.c"

config SERIRQ_CONTINUOUS_MODE
	bool
	default n
	help
	  If you set this option to y, the serial IRQ machine will be
	  operated in continuous mode.

config HPET_MIN_TICKS
	hex
	default 0x80

config INCLUDE_ME
	bool "Add Intel descriptor.bin file"
	default n
	help
	  Include the descriptor.bin for the SOC.  This is required for the
	  SOC to boot.

config ME_PATH
	string "Path to descriptor.bin file"
	depends on INCLUDE_ME
	default "../intel/mainboard/intel/rangeley"
	help
	  The path of the descriptor.bin file.

config ACPI_INCLUDE_GPIO
	bool
	depends on GENERATE_ACPI_TABLES
	default n if GPIO_TPM
	default y if !GPIO_TPM
	help
	  If the LPC or GPIO driver is enabled in Linux, it will complain
	  about the driver's IO area conflicting with the ACPI GPIO
	  section if this is enabled:
	  "ACPI Warning: 0x0000000000000530-0x000000000000053f SystemIO conflicts
	  with Region \GPIO 1"
	  "ACPI Warning: 0x0000000000000500-0x000000000000052f SystemIO conflicts
	  with Region \GPIO 1"
	  If ACPI does not need to access the GPIO region to look at the GPIO
	  states, this should be safe to disable.

config ACPI_INCLUDE_PMIO
	bool
	depends on GENERATE_ACPI_TABLES
	default n if GPIO_TPM
	default y if !GPIO_TPM
	help
	  If the LPC driver is enabled in Linux, it will complain about
	  the driver's IO area conflicting with the ACPI GPIO section if
	  this is enabled:
	  "ACPI Warning: 0x0000000000000428-0x000000000000042f SystemIO conflicts
	  with Region \PMIO 1"
	  If ACPI does not need to access the PMIO region to look at the SCI
	  states, this should be safe to disable.

endif
```

## trunk/package/nfq-example/Config.in
```kconfig
# nfq-example configuration

if PACKAGE_nfq-example

	config NFQ_EXAMPLE_CONFIG
		bool "nfq-example config blurb"
		help
			just for kicks
		default n

endif
```

## trunk/package/qemu/Config.in
```kconfig
# qemu configuration

if PACKAGE_qemu

	config QEMU
		bool "QEMU for virtual machines on vwlocloud edge"
		help
			Say Y if you want to run guest OSes on the Velocloud edge.
		default y

endif
```

## trunk/target/linux/x64/image/Config.in
```kconfig
config X86_GRUB_IMAGES
	bool "Build GRUB images (Linux x86 or x86_64 host only)"
	depends on TARGET_x64
	depends on TARGET_ROOTFS_EXT4FS || TARGET_ROOTFS_ISO || TARGET_ROOTFS_JFFS2 || TARGET_ROOTFS_SQUASHFS
	select PACKAGE_grub2
	default y

config X86_GRUB_CONSOLE
	bool "Use Console Terminal (in addition to Serial)"
	depends on X86_GRUB_IMAGES
	default y

config X86_GRUB_SERIAL
	string "Serial port device"
	depends on X86_GRUB_IMAGES
	default "hvc0" if TARGET_x64_vc_xen_aws
	default "ttyPCH0" if TARGET_x64_sb_itc
	default "ttyS1" if TARGET_x64_pw_dev
	default "ttyS0" if TARGET_x64_edge500
	default "ttyS0" if ! TARGET_x64_sb_itc
	help
	  Name of serial port device.

config X86_GRUB_SERIAL_UNIT
	string "Serial port grub unit"
	depends on X86_GRUB_IMAGES
	default "1" if TARGET_x64_pw_dev
	default "0" if TARGET_x64_edge500
	default "0"
	help
	  Unit name of serial port device for grub itself.
	  This could be different from X86_GRUB_SERIAL, depending on grub serial device order.

config X86_GRUB_BAUDRATE
	int "Serial port baud rate"
	depends on X86_GRUB_IMAGES
	default 115200

config X86_GRUB_BOOTOPTS
	string "Extra kernel boot options"
	depends on X86_GRUB_IMAGES
	default "xencons=hvc" if TARGET_x64_vc_xen_aws
	default "earlyprintk=pch,0x3058,115200" if TARGET_x64_sb_itc
	default "earlyprintk=serial,ttyS1,115200" if TARGET_x64_pw_dev
	default "earlyprintk=serial,ttyS0,115200" if TARGET_x64_edge500
	help
	  If you don't know, just leave it blank.

config X86_GRUB_TIMEOUT
	string "Seconds to wait before booting the default entry"
	depends on X86_GRUB_IMAGES
	default "5"
	help
	  If you don't know, 5 seconds is a reasonable default.

config X86_VDI_IMAGES
	bool "Build VirtualBox image files (VDI)"
	depends on X86_GRUB_IMAGES
	depends on TARGET_x64
	depends on TARGET_ROOTFS_EXT4FS
	select PACKAGE_kmod-pcnet32

config X86_VELOCLOUD_INSTALLER
	bool "Build Velocloud installer image"
	depends on X86_GRUB_IMAGES
	depends on TARGET_x64
	depends on TARGET_ROOTFS_EXT4FS
	default y if TARGET_x64_sb_itc
	default y if TARGET_x64_edge500
	default y if TARGET_x64_pw_dev

config X86_VMDK_IMAGES
	bool "Build VMware image files (VMDK)"
	depends on X86_GRUB_IMAGES
	depends on TARGET_x64
	depends on TARGET_ROOTFS_EXT4FS
	default y if TARGET_x64_vc_vmdk
	default y if TARGET_x64_vc_xen_aws
	select PACKAGE_kmod-e1000
	select PACKAGE_kmod-pcnet32

config X86_EC2_IMAGES
	bool "Build Amazon EC2 image files"
	default y if TARGET_x64_vc_xen_aws
	depends on X86_GRUB_IMAGES
	depends on TARGET_ROOTFS_EXT4FS

config TARGET_ROOTFS_EC2_PARTNAME
	string "Root partition on EC2 target image"
	depends on TARGET_x64_vc_xen_aws
	depends on X86_GRUB_IMAGES
	default "/dev/xvda1"

config TARGET_IMAGES_GZIP
	bool "GZip images"
	depends on TARGET_IMAGES_PAD || TARGET_ROOTFS_EXT4FS
	default y

config TARGET_KERNEL_PARTSIZE
	int "Boot partition size (in MB)"
	depends on OLPC_BOOTSCRIPT_IMAGES || X86_GRUB_IMAGES
	default 4

config TARGET_ROOTFS_PARTNAME
	string "Root partition on target device"
	depends on OLPC_BOOTSCRIPT_IMAGES || X86_GRUB_IMAGES
	default "/dev/sdb2" if TARGET_x64_pw_dev
	default "/dev/sdb2" if TARGET_x64_edge500
	default "/dev/xvda2" if TARGET_x64_vc_xen_aws
	default "/dev/sda2"
	help
	  The root partition on the final device.  If you don't know,
	  you probably want the default (/dev/sda2).

config TARGET_ROOTFS_INSTSIZE
	int "Installed root partition size (in MB)"
	depends on X86_GRUB_IMAGES && (TARGET_x64_sb_itc||TARGET_x64_pw_dev||TARGET_x64_edge500)
	default 1024
```
